/dts-v1/;

/ {

	__fixups__ {
		accdet = "/fragment@39:target:0";
		android = "/fragment@14:target:0";
		camera_af_hw_node = "/fragment@8:target:0";
		charger = "/fragment@36:target:0";
		chosen = "/fragment@13:target:0";
		cust_gpios = "/fragment@22:target:0";
		disp_pwm = "/fragment@15/__overlay__/backlight:pwms:0";
		dispsys_config = "/fragment@18:target:0";
		dsi0 = "/fragment@19:target:0";
		dsi_te = "/fragment@48:target:0";
		extcon_usb = "/fragment@38:target:0";
		flashlights_cp2155 = "/fragment@10:target:0";
		gpio = "/fragment@45:target:0";
		gpio_usage_mapping = "/fragment@44:target:0";
		gps = "/fragment@23:target:0";
		i2c0 = "/fragment@28:target:0";
		i2c1 = "/fragment@29:target:0";
		i2c2 = "/fragment@2:target:0";
		i2c3 = "/fragment@30:target:0";
		i2c4 = "/fragment@3:target:0";
		i2c6 = "/fragment@6:target:0", "/fragment@33:target:0";
		i2c7 = "/fragment@31:target:0";
		i2c8 = "/fragment@4:target:0";
		kd_camera_hw1 = "/fragment@1:target:0";
		keypad = "/fragment@51:target:0";
		leds = "/fragment@34:target:0";
		lk_charger = "/fragment@35:target:0";
		md1_sim1_hot_plug_eint = "/fragment@49:target:0";
		md1_sim2_hot_plug_eint = "/fragment@50:target:0";
		mtk_composite_v4l2_1 = "/fragment@7:target:0";
		mtk_gauge = "/fragment@11:target:0", "/fragment@37:target:0";
		mtk_leds = "/fragment@15:target:0";
		mtkfb = "/fragment@17:target:0";
		odm = "/fragment@20:target:0";
		pdc = "/fragment@43:target:0";
		pe = "/fragment@42:target:0";
		pe2 = "/fragment@41:target:0";
		pe4 = "/fragment@40:target:0";
		pio = "/fragment@0:target:0", "/fragment@9:target:0", "/fragment@16:target:0", "/fragment@20/__overlay__/gpio-keys/lid:gpios:0", "/fragment@21:target:0", "/fragment@22/__overlay__:gpio_bias_pos:0", "/fragment@22/__overlay__:gpio_bias_neg:0", "/fragment@22/__overlay__:gpio_bias_en:0", "/fragment@22/__overlay__:gpio_lcm_1v8:0", "/fragment@22/__overlay__:gpio_lcm_3v3:0", "/fragment@22/__overlay__:gpio_lcm_rst:0", "/fragment@22/__overlay__:gpio_usb_hp_sw:0", "/fragment@24/__overlay__/himax@0:interrupt-parent:0", "/fragment@24/__overlay__/himax@0:himax,rst-gpio:0", "/fragment@24/__overlay__/himax@0:himax,irq-gpio:0", "/fragment@25:target:0", "/fragment@26/__overlay__/focaltech@0:focaltech,reset-gpio:0", "/fragment@26/__overlay__/focaltech@0:focaltech,irq-gpio:0", "/fragment@27:target:0", "/fragment@31/__overlay__/aw882xx_smartpa_0@35:irq-gpio:0", "/fragment@31/__overlay__/aw882xx_smartpa_1@34:irq-gpio:0", "/fragment@38/__overlay__:id-gpios:0", "/fragment@44/__overlay__:GPIO_SIM1_HOT_PLUG:0", "/fragment@44/__overlay__:GPIO_SIM2_HOT_PLUG:0", "/fragment@44/__overlay__:GPIO_SIM1_SCLK:0", "/fragment@44/__overlay__:GPIO_SIM1_SRST:0", "/fragment@44/__overlay__:GPIO_SIM1_SIO:0", "/fragment@44/__overlay__:GPIO_SIM2_SCLK:0", "/fragment@44/__overlay__:GPIO_SIM2_SRST:0", "/fragment@44/__overlay__:GPIO_SIM2_SIO:0", "/fragment@44/__overlay__:GPIO_FDD_BAND_SUPPORT_DETECT_1ST_PIN:0", "/fragment@46/__overlay__:interrupt-parent:0", "/fragment@47/__overlay__:interrupt-parent:0", "/fragment@48/__overlay__:interrupt-parent:0";
		reserved_memory = "/fragment@12:target:0";
		sound = "/fragment@32:target:0";
		spi0 = "/fragment@24:target:0", "/fragment@26:target:0";
		subpmic_pmu_eint = "/fragment@46:target:0";
		thermal_zones = "/fragment@5:target:0";
		touch = "/fragment@47:target:0";
		upm6920_chg = "/fragment@36/__overlay__:charger:0", "/fragment@37/__overlay__:charger:0", "/fragment@38/__overlay__:charger:0";
	};

	__local_fixups__ {

		fragment {

			__overlay__ {

				lcds {

					cust_lk_panel {

						display-timings {
							native-mode = <0x0>;
						};
					};

					m100t_ft8201_xy2210d4001a_wuxga2000_pt2 {

						display-timings {
							native-mode = <0x0>;
						};
					};

					m100t_jd9366tc_sq110aq7ez51394l501_wuxga2000_jst_864 {

						display-timings {
							native-mode = <0x0>;
						};
					};
				};
			};
		};

		fragment@1 {

			__overlay__ {
				pinctrl-0 = <0x0>;
				pinctrl-1 = <0x0>;
				pinctrl-10 = <0x0>;
				pinctrl-11 = <0x0>;
				pinctrl-12 = <0x0>;
				pinctrl-13 = <0x0>;
				pinctrl-14 = <0x0>;
				pinctrl-15 = <0x0>;
				pinctrl-16 = <0x0>;
				pinctrl-17 = <0x0>;
				pinctrl-18 = <0x0>;
				pinctrl-19 = <0x0>;
				pinctrl-2 = <0x0>;
				pinctrl-20 = <0x0>;
				pinctrl-21 = <0x0>;
				pinctrl-22 = <0x0>;
				pinctrl-23 = <0x0>;
				pinctrl-24 = <0x0>;
				pinctrl-25 = <0x0>;
				pinctrl-26 = <0x0>;
				pinctrl-27 = <0x0>;
				pinctrl-28 = <0x0>;
				pinctrl-29 = <0x0>;
				pinctrl-3 = <0x0>;
				pinctrl-30 = <0x0>;
				pinctrl-31 = <0x0>;
				pinctrl-32 = <0x0>;
				pinctrl-33 = <0x0>;
				pinctrl-34 = <0x0>;
				pinctrl-35 = <0x0>;
				pinctrl-36 = <0x0>;
				pinctrl-37 = <0x0>;
				pinctrl-38 = <0x0>;
				pinctrl-39 = <0x0>;
				pinctrl-4 = <0x0>;
				pinctrl-40 = <0x0>;
				pinctrl-41 = <0x0>;
				pinctrl-42 = <0x0>;
				pinctrl-43 = <0x0>;
				pinctrl-44 = <0x0>;
				pinctrl-45 = <0x0>;
				pinctrl-46 = <0x0>;
				pinctrl-47 = <0x0>;
				pinctrl-48 = <0x0>;
				pinctrl-49 = <0x0>;
				pinctrl-5 = <0x0>;
				pinctrl-50 = <0x0>;
				pinctrl-51 = <0x0>;
				pinctrl-6 = <0x0>;
				pinctrl-7 = <0x0>;
				pinctrl-8 = <0x0>;
				pinctrl-9 = <0x0>;
			};
		};

		fragment@10 {

			__overlay__ {
				pinctrl-0 = <0x0>;
				pinctrl-1 = <0x0>;
				pinctrl-2 = <0x0>;
				pinctrl-3 = <0x0>;
			};
		};

		fragment@17 {

			__overlay__ {
				pinctrl-0 = <0x0>;
				pinctrl-1 = <0x0>;
				pinctrl-10 = <0x0>;
				pinctrl-11 = <0x0>;
				pinctrl-2 = <0x0>;
				pinctrl-3 = <0x0>;
				pinctrl-4 = <0x0>;
				pinctrl-5 = <0x0>;
				pinctrl-6 = <0x0>;
				pinctrl-7 = <0x0>;
				pinctrl-8 = <0x0>;
				pinctrl-9 = <0x0>;
			};
		};

		fragment@18 {

			__overlay__ {
				pinctrl-0 = <0x0>;
				pinctrl-1 = <0x0>;
				pinctrl-2 = <0x0>;
			};
		};

		fragment@19 {

			__overlay__ {

				panel1@0 {

					port {

						endpoint {
							remote-endpoint = <0x0>;
						};
					};
				};

				ports {

					port {

						endpoint {
							remote-endpoint = <0x0>;
						};
					};
				};
			};
		};

		fragment@23 {

			__overlay__ {
				pinctrl-0 = <0x0>;
				pinctrl-1 = <0x0>;
				pinctrl-2 = <0x0>;
				pinctrl-3 = <0x0>;
				pinctrl-4 = <0x0>;
				pinctrl-5 = <0x0>;
				pinctrl-6 = <0x0>;
			};
		};

		fragment@24 {

			__overlay__ {
				pinctrl-0 = <0x0>;

				himax@0 {
					pinctrl-0 = <0x0>;
					pinctrl-1 = <0x0>;
				};
			};
		};

		fragment@26 {

			__overlay__ {

				focaltech@0 {
					pinctrl-0 = <0x0>;
					pinctrl-1 = <0x0>;
				};
			};
		};

		fragment@32 {

			__overlay__ {

				mediatek,speaker-codec {
					sound-dai = <0x0 0x4>;
				};
			};
		};

		fragment@5 {

			__overlay__ {

				camera_main {
					thermal-sensors = <0x0>;
				};

				camera_main_two {
					thermal-sensors = <0x0>;
				};

				camera_sub {
					thermal-sensors = <0x0>;
				};
			};
		};

		fragment@6 {

			__overlay__ {

				lm3643@63 {

					flash@0 {

						port@0 {

							endpoint {
								remote-endpoint = <0x0>;
							};
						};
					};

					flash@1 {

						port@1 {

							endpoint {
								remote-endpoint = <0x0>;
							};
						};
					};
				};
			};
		};

		fragment@7 {

			__overlay__ {

				port@0 {

					endpoint {
						remote-endpoint = <0x0>;
					};
				};

				port@1 {

					endpoint {
						remote-endpoint = <0x0>;
					};
				};
			};
		};
	};

	__symbols__ {
		aw882xx_smartpa_0 = "/fragment@31/__overlay__/aw882xx_smartpa_0@35";
		aw882xx_smartpa_1 = "/fragment@31/__overlay__/aw882xx_smartpa_1@34";
		camera_main = "/fragment@5/__overlay__/camera_main";
		camera_main_af_mtk = "/fragment@4/__overlay__/camera_main_af@72";
		camera_main_mtk = "/fragment@4/__overlay__/camera_main@1a";
		camera_main_three_af_mtk = "/fragment@2/__overlay__/camera_main_three_af@0c";
		camera_main_two = "/fragment@5/__overlay__/camera_main_two";
		camera_main_two_af_mtk = "/fragment@2/__overlay__/camera_main_two_af@0d";
		camera_main_two_mtk = "/fragment@2/__overlay__/camera_main_two@10";
		camera_pins_cam0_ldo_vcama_0 = "/fragment@0/__overlay__/vcama@0";
		camera_pins_cam0_ldo_vcama_1 = "/fragment@0/__overlay__/vcama@1";
		camera_pins_cam0_ldo_vcamaf_0 = "/fragment@0/__overlay__/vcamaf@0";
		camera_pins_cam0_ldo_vcamaf_1 = "/fragment@0/__overlay__/vcamaf@1";
		camera_pins_cam0_ldo_vcamd_0 = "/fragment@0/__overlay__/vcamd@0";
		camera_pins_cam0_ldo_vcamd_1 = "/fragment@0/__overlay__/vcamd@1";
		camera_pins_cam0_ldo_vcamio_0 = "/fragment@0/__overlay__/vcamio@0";
		camera_pins_cam0_ldo_vcamio_1 = "/fragment@0/__overlay__/vcamio@1";
		camera_pins_cam0_mclk_2ma = "/fragment@0/__overlay__/camera_pins_cam0_mclk_2ma";
		camera_pins_cam0_mclk_4ma = "/fragment@0/__overlay__/camera_pins_cam0_mclk_4ma";
		camera_pins_cam0_mclk_6ma = "/fragment@0/__overlay__/camera_pins_cam0_mclk_6ma";
		camera_pins_cam0_mclk_8ma = "/fragment@0/__overlay__/camera_pins_cam0_mclk_8ma";
		camera_pins_cam0_mclk_off = "/fragment@0/__overlay__/camera_pins_cam0_mclk_off";
		camera_pins_cam0_pnd_0 = "/fragment@0/__overlay__/cam0@2";
		camera_pins_cam0_pnd_1 = "/fragment@0/__overlay__/cam0@3";
		camera_pins_cam0_rst_0 = "/fragment@0/__overlay__/cam0@0";
		camera_pins_cam0_rst_1 = "/fragment@0/__overlay__/cam0@1";
		camera_pins_cam1_ldo_vcama_0 = "/fragment@0/__overlay__/vcama_1@0";
		camera_pins_cam1_ldo_vcama_1 = "/fragment@0/__overlay__/vcama_1@1";
		camera_pins_cam1_ldo_vcamaf_0 = "/fragment@0/__overlay__/vcamaf_1@0";
		camera_pins_cam1_ldo_vcamaf_1 = "/fragment@0/__overlay__/vcamaf_1@1";
		camera_pins_cam1_ldo_vcamd_0 = "/fragment@0/__overlay__/vcamd_1@0";
		camera_pins_cam1_ldo_vcamd_1 = "/fragment@0/__overlay__/vcamd_1@1";
		camera_pins_cam1_ldo_vcamio_0 = "/fragment@0/__overlay__/vcamio_1@0";
		camera_pins_cam1_ldo_vcamio_1 = "/fragment@0/__overlay__/vcamio_1@1";
		camera_pins_cam1_mclk_2ma = "/fragment@0/__overlay__/camera_pins_cam1_mclk_2ma";
		camera_pins_cam1_mclk_4ma = "/fragment@0/__overlay__/camera_pins_cam1_mclk_4ma";
		camera_pins_cam1_mclk_6ma = "/fragment@0/__overlay__/camera_pins_cam1_mclk_6ma";
		camera_pins_cam1_mclk_8ma = "/fragment@0/__overlay__/camera_pins_cam1_mclk_8ma";
		camera_pins_cam1_mclk_off = "/fragment@0/__overlay__/camera_pins_cam1_mclk_off";
		camera_pins_cam1_pnd_0 = "/fragment@0/__overlay__/cam1@2";
		camera_pins_cam1_pnd_1 = "/fragment@0/__overlay__/cam1@3";
		camera_pins_cam1_rst_0 = "/fragment@0/__overlay__/cam1@0";
		camera_pins_cam1_rst_1 = "/fragment@0/__overlay__/cam1@1";
		camera_pins_cam2_ldo_vcama_0 = "/fragment@0/__overlay__/vcama_2@0";
		camera_pins_cam2_ldo_vcama_1 = "/fragment@0/__overlay__/vcama_2@1";
		camera_pins_cam2_ldo_vcamaf_0 = "/fragment@0/__overlay__/vcamaf_2@0";
		camera_pins_cam2_ldo_vcamaf_1 = "/fragment@0/__overlay__/vcamaf_2@1";
		camera_pins_cam2_ldo_vcamd_0 = "/fragment@0/__overlay__/vcamd_2@0";
		camera_pins_cam2_ldo_vcamd_1 = "/fragment@0/__overlay__/vcamd_2@1";
		camera_pins_cam2_ldo_vcamio_0 = "/fragment@0/__overlay__/vcamio_2@0";
		camera_pins_cam2_ldo_vcamio_1 = "/fragment@0/__overlay__/vcamio_2@1";
		camera_pins_cam2_mclk_2ma = "/fragment@0/__overlay__/camera_pins_cam2_mclk_2ma";
		camera_pins_cam2_mclk_4ma = "/fragment@0/__overlay__/camera_pins_cam2_mclk_4ma";
		camera_pins_cam2_mclk_6ma = "/fragment@0/__overlay__/camera_pins_cam2_mclk_6ma";
		camera_pins_cam2_mclk_8ma = "/fragment@0/__overlay__/camera_pins_cam2_mclk_8ma";
		camera_pins_cam2_mclk_off = "/fragment@0/__overlay__/camera_pins_cam2_mclk_off";
		camera_pins_cam2_pnd_0 = "/fragment@0/__overlay__/cam2@2";
		camera_pins_cam2_pnd_1 = "/fragment@0/__overlay__/cam2@3";
		camera_pins_cam2_rst_0 = "/fragment@0/__overlay__/cam2@0";
		camera_pins_cam2_rst_1 = "/fragment@0/__overlay__/cam2@1";
		camera_pins_default = "/fragment@0/__overlay__/camdefault";
		camera_sub = "/fragment@5/__overlay__/camera_sub";
		camera_sub_mtk = "/fragment@3/__overlay__/camera_sub@1a";
		cust_lk_panel = "/fragment/__overlay__/lcds/cust_lk_panel";
		cust_lk_panel_timing = "/fragment/__overlay__/lcds/cust_lk_panel/display-timings/timing0";
		dsi_out = "/fragment@19/__overlay__/ports/port/endpoint";
		fl_core_0 = "/fragment@6/__overlay__/lm3643@63/flash@0/port@0/endpoint";
		fl_core_1 = "/fragment@6/__overlay__/lm3643@63/flash@1/port@1/endpoint";
		flashlight_0 = "/fragment@7/__overlay__/port@0/endpoint";
		flashlight_1 = "/fragment@7/__overlay__/port@1/endpoint";
		flashlights_cp2155_pins_hwen_high = "/fragment@9/__overlay__/hwen_high";
		flashlights_cp2155_pins_hwen_low = "/fragment@9/__overlay__/hwen_low";
		flashlights_cp2155_pins_mode_high = "/fragment@9/__overlay__/mode_high";
		flashlights_cp2155_pins_mode_low = "/fragment@9/__overlay__/mode_low";
		fts_spi_pull_down_ctrl = "/fragment@27/__overlay__/fts_spi_pull_down_ctrl";
		fts_spi_pull_up_ctrl = "/fragment@27/__overlay__/fts_spi_pull_up_ctrl";
		gpio_keys = "/fragment@20/__overlay__/gpio-keys";
		gps_l1_lna_pins_dsp_ctrl = "/fragment@21/__overlay__/gps_l1_lna@1";
		gps_l1_lna_pins_oh = "/fragment@21/__overlay__/gps_l1_lna@2";
		gps_l1_lna_pins_ol = "/fragment@21/__overlay__/gps_l1_lna@0";
		gps_l5_lna_pins_dsp_ctrl = "/fragment@21/__overlay__/gps_l5_lna@1";
		gps_l5_lna_pins_oh = "/fragment@21/__overlay__/gps_l5_lna@2";
		gps_l5_lna_pins_ol = "/fragment@21/__overlay__/gps_l5_lna@0";
		gps_pins_default = "/fragment@21/__overlay__/gps_default";
		lm3643 = "/fragment@6/__overlay__/lm3643@63";
		m100t_ft8201_xy2210d4001a_wuxga2000_pt2 = "/fragment/__overlay__/lcds/m100t_ft8201_xy2210d4001a_wuxga2000_pt2";
		m100t_ft8201_xy2210d4001a_wuxga2000_pt2_timing = "/fragment/__overlay__/lcds/m100t_ft8201_xy2210d4001a_wuxga2000_pt2/display-timings/timing0";
		m100t_jd9366tc_sq110aq7ez51394l501_wuxga2000_jst_864 = "/fragment/__overlay__/lcds/m100t_jd9366tc_sq110aq7ez51394l501_wuxga2000_jst_864";
		m100t_jd9366tc_sq110aq7ez51394l501_wuxga2000_jst_864_timing = "/fragment/__overlay__/lcds/m100t_jd9366tc_sq110aq7ez51394l501_wuxga2000_jst_864/display-timings/timing0";
		mtk_camera_eeprom0 = "/fragment@4/__overlay__/camera_eeprom0@50";
		mtk_camera_eeprom1 = "/fragment@3/__overlay__/camera_eeprom1@51";
		mtk_camera_eeprom2 = "/fragment@2/__overlay__/camera_eeprom2@51";
		mtkfb_pins_lcd_bias_enn0 = "/fragment@16/__overlay__/lcd_bias_enn0_gpio";
		mtkfb_pins_lcd_bias_enn1 = "/fragment@16/__overlay__/lcd_bias_enn1_gpio";
		mtkfb_pins_lcd_bias_enp0 = "/fragment@16/__overlay__/lcd_bias_enp0_gpio";
		mtkfb_pins_lcd_bias_enp1 = "/fragment@16/__overlay__/lcd_bias_enp1_gpio";
		mtkfb_pins_lcd_pwr_1v8_en = "/fragment@16/__overlay__/lcd_pwr_1v8_en_gpio";
		mtkfb_pins_lcd_pwr_3v3_en = "/fragment@16/__overlay__/lcd_pwr_3v3_en_gpio";
		mtkfb_pins_lcm_dsi_te = "/fragment@16/__overlay__/lcm_dsi_te";
		mtkfb_pins_lcm_led_en0 = "/fragment@16/__overlay__/lcm_led_en0_gpio";
		mtkfb_pins_lcm_led_en1 = "/fragment@16/__overlay__/lcm_led_en1_gpio";
		mtkfb_pins_lcm_rst_out0_gpio = "/fragment@16/__overlay__/lcm_rst_out0_gpio";
		mtkfb_pins_lcm_rst_out1_gpio = "/fragment@16/__overlay__/lcm_rst_out1_gpio";
		mtkfb_pins_tp_rst_gpio = "/fragment@16/__overlay__/tp_rst_gpio";
		panel_in1 = "/fragment@19/__overlay__/panel1@0/port/endpoint";
		spi_pins_0 = "/fragment@25/__overlay__/spi0@1";
		spi_pull_down_ctrl = "/fragment@25/__overlay__/spi_pull_down_ctrl";
		spi_pull_up_ctrl = "/fragment@25/__overlay__/spi_pull_up_ctrl";
	};

	fragment {
		target-path = [2f 00];

		__overlay__ {

			lcds {

				cust_lk_panel {
					phandle = <0x69>;

					display-timings {
						native-mode = <0x40>;

						timing0 {
							clock-frequency = <0x927c000>;
							hactive = <0x320>;
							hback-porch = <0x50>;
							hfront-porch = <0x50>;
							hsync-len = <0xc>;
							phandle = <0x40>;
							vactive = <0x500>;
							vback-porch = <0x28>;
							vfront-porch = <0x1e>;
							vsync-len = <0x4>;
						};
					};
				};

				m100t_ft8201_xy2210d4001a_wuxga2000_pt2 {
					cust,data_rate = <0x434>;
					cust,dsi-color-format = "rgb888";
					cust,dsi-lane-number = <0x4>;
					cust,dsi-non-continuous-clock = <0x0>;
					cust,dsi-work-mode = <0x4>;
					cust,enable_dts_lcd = <0x1>;
					cust,esd-check-enable = <0x0>;
					cust,esd-check-mode = <0x0>;
					cust,esd-check-register = <0xa>;
					cust,esd-check-value = <0x9c>;
					cust,fps = <0x3c>;
					cust,initial-command = [00 02 50 5a 00 02 54 03 00 03 50 5a 03 00 02 80 ee 00 03 50 5a 08 00 03 80 c8 00 00 03 50 5a 09 00 11 80 5a 51 b5 2a 6c d5 4a 01 80 e0 cd f3 3c 0f 00 b7 00 11 90 00 3f 42 0a e3 6d db f0 91 5c 62 20 6b a1 26 00 00 07 a0 01 82 08 20 06 00 00 03 50 5a 0a 00 11 80 a5 4b 03 00 1c 30 48 5f 72 7c b1 b4 ef 4a 18 6a 00 11 90 43 43 36 2a 1c 16 17 00 1c 30 48 5f 72 7c b1 b4 00 0d a0 ef 4a 18 6a 43 43 36 2a 1c 16 03 00 00 03 50 5a 0b 00 11 80 00 00 20 44 08 00 60 47 00 00 10 22 04 00 b0 23 00 03 90 15 00 00 03 50 5a 0c 00 11 80 fe 68 58 82 3e 64 b8 06 00 60 15 00 50 15 56 51 00 11 90 15 55 61 15 00 60 15 00 50 15 56 51 15 55 61 95 00 11 a0 ab 18 00 05 00 05 00 05 80 4c 29 84 52 01 09 00 00 03 50 5a 0d 00 0f 80 f0 b1 71 ef 49 c0 80 1a 00 00 00 00 00 00 00 03 50 5a 0e 00 0d 80 ff 81 68 ec 22 6d 22 00 00 00 00 00 00 03 50 5a 0f 00 11 80 0d 08 4a 00 25 80 64 0c 51 11 c8 50 01 42 8c 8c 00 08 90 24 69 81 71 44 7c 14 00 03 50 5a 10 00 11 80 00 78 03 e7 1f 17 00 78 20 d3 d4 18 30 88 41 8a 00 10 90 39 28 a9 c5 9a 7b fa 07 7e e0 07 7e 20 10 00 00 03 50 5a 11 00 11 80 46 77 03 40 ca f3 ff 83 30 08 c4 06 a1 d8 24 18 00 11 90 30 c6 66 c1 80 31 15 cb e5 d2 68 6c 36 1d 04 c8 00 11 a0 b0 d9 88 60 b0 81 40 1a 1b 48 63 03 b9 00 1c 80 00 11 b0 50 30 00 e0 e1 01 00 28 0e 06 43 55 55 55 55 55 00 11 c0 95 88 88 88 88 88 c8 08 86 c6 e3 81 00 20 00 21 00 11 d0 42 88 00 00 00 00 40 00 00 31 04 41 06 00 00 00 00 11 e0 00 00 00 00 00 00 00 00 00 00 92 04 00 85 11 0c 00 0a f0 00 00 40 00 00 00 00 5e 00 00 03 50 5a 12 00 11 80 00 00 00 00 00 00 00 00 00 00 00 00 00 00 00 00 00 0a 90 00 00 00 00 00 00 00 74 00 00 03 50 5a 13 00 11 80 01 00 00 0c 00 00 00 00 01 02 01 01 44 0c ce e7 00 04 90 62 06 00 00 03 50 5a 14 00 11 80 d1 00 40 5e e9 ef f7 fb fd 7e 01 00 00 f4 c5 41 00 11 90 88 1c 60 0e 42 e4 00 9b 10 22 07 80 8b 10 39 80 00 11 a0 39 e4 c8 08 cc 80 21 45 00 00 00 00 00 00 00 00 00 11 b0 00 00 00 00 00 00 10 00 00 ec be e8 1b 00 40 a1 00 11 c0 50 b8 01 21 72 80 31 00 37 21 44 0e 30 06 e0 46 00 11 d0 84 c8 01 c6 00 dc 8c 10 39 c0 18 80 1b 12 22 07 00 11 e0 18 03 70 53 42 e4 00 63 00 dc 04 8e 1c 60 0c 80 00 11 f0 7b c0 91 07 8c 01 18 01 bf 5f 08 00 00 00 00 00 00 03 50 5a 15 00 11 80 00 00 00 00 00 00 00 00 00 00 00 00 52 d4 e0 e7 00 11 90 f3 00 e8 63 41 c8 80 86 60 40 1d 31 32 a0 21 18 00 11 a0 50 00 00 00 00 00 00 00 00 00 00 00 00 00 00 00 00 11 b0 00 00 00 00 00 00 00 40 13 00 f0 00 94 b6 6d db 00 11 c0 b6 6d db 95 92 3e 4e 41 0c 42 00 a0 b6 6d db b6 00 11 d0 6d db b6 5d ab e8 e3 82 a1 38 92 65 6a db b6 6d 00 11 e0 db b6 6d db b5 9a 3e 6e 49 8e 62 08 a2 b6 6d db 00 11 f0 b6 6d db b6 5d 29 e8 e3 00 81 30 10 45 6a 5b 00 00 03 50 5a 16 00 11 80 00 00 00 00 00 00 00 00 00 00 00 00 00 00 00 00 00 07 90 00 00 00 00 90 40 00 03 50 5a 18 00 11 80 ef bd f7 de 7b ef bd 07 08 08 0a 0c 0c 0c 0c 0c 00 11 90 0c 0c 0c 5c 09 a8 aa aa aa aa aa aa aa aa aa 5a 00 11 a0 59 59 59 59 59 59 59 59 59 59 59 09 04 ff 05 80 00 10 b0 80 00 04 20 00 01 08 40 00 02 10 80 00 04 0f 00 03 50 5a 19 00 11 80 eb d6 b9 b3 a8 9d 98 91 8c 87 84 82 66 f6 ff ff 00 11 90 ff ff ff ff ff 7f 0f 0f af b5 71 0e 6c 4a 69 08 00 08 a0 00 04 62 00 00 00 00 00 03 50 5a 1a 00 11 80 00 04 08 0c 00 10 14 18 1c 00 20 28 30 38 00 3f 00 11 90 47 4f 57 ff 5f 67 6f 77 aa 7f 87 8f 97 aa 9f a7 00 11 a0 af b7 ff bf c7 d0 d8 0f e0 e8 f0 f8 00 fc fe ff 00 11 b0 00 00 03 07 0b bc 0f 13 17 1b 16 1f 26 2e 36 6c 00 11 c0 3e 45 4d 55 6c 5d 65 6c 74 b0 7c 84 8b 93 b1 9b 00 11 d0 a3 aa b2 61 ba c1 c9 d1 6c d9 e0 e8 f0 6c f4 f6 00 11 e0 f7 00 00 03 07 0b ac 0f 13 16 1a b1 1e 26 2d 35 00 11 f0 21 3c 44 4b 53 77 5b 62 6a 71 88 79 80 88 90 1d 00 03 50 5a 1b 00 11 80 97 9f a6 ae 72 b6 bd c5 cd 1c d4 dc e4 ec 5b f0 00 05 90 f2 f3 15 00 00 03 50 5a 20 00 08 80 90 00 00 00 00 00 00 00 03 50 5a 22 00 0e 80 2d d3 00 41 10 04 41 10 04 41 10 1e 00 00 03 50 5a 23 00 11 80 01 05 00 05 00 00 00 00 00 00 00 00 00 00 00 00 00 0a 90 ff 0f 00 00 2c 00 00 00 00 00 03 50 5a 24 00 11 80 00 03 00 9d bf 10 00 00 00 00 00 00 00 00 77 62 00 02 90 a5 00 03 50 5a 2f 00 02 09 01 78 02 11 00 0a 02 29 00];
					cust,lcm_phy_size = <0x40c>;
					cust,mipi_dsi_mode_lpm = <0x1>;
					cust,pll_clk = <0x223>;
					cust,power-off-sequence = <0x16 0x0 0x0 0x11 0x0 0xa 0x4 0x0 0xa 0x13 0x0 0x2 0x14 0x0 0x0>;
					cust,power-on-sequence = <0x4 0x1 0xa 0x13 0x1 0x1 0x14 0x1 0x14 0x11 0x0 0x1 0x11 0x1 0x1 0x5 0x1 0xa 0x5 0x0 0x2 0x5 0x1 0x5>;
					cust,power-on-sequence_after_cmd = <0x16 0x1 0x0>;
					cust,rotate = <0x1>;
					cust,sleep-in-command = [0a 01 28 78 01 10];
					cust,sleep-out-command = [78 01 11 64 01 29];
					cust,ssc_enable = <0x0>;
					phandle = <0x6a>;
					use_drm_panel = "dts_lcm_panel";

					display-timings {
						native-mode = <0x41>;

						timing0 {
							clock-frequency = <0x927c000>;
							hactive = <0x4b0>;
							hback-porch = <0x6>;
							hfront-porch = <0x6>;
							hsync-len = <0x5>;
							phandle = <0x41>;
							vactive = <0x7d0>;
							vback-porch = <0x22>;
							vfront-porch = <0xff>;
							vsync-len = <0x6>;
						};
					};
				};

				m100t_jd9366tc_sq110aq7ez51394l501_wuxga2000_jst_864 {
					cust,data_rate = <0x44c>;
					cust,dsi-color-format = "rgb888";
					cust,dsi-lane-number = <0x4>;
					cust,dsi-non-continuous-clock = <0x0>;
					cust,dsi-work-mode = <0x4>;
					cust,enable_dts_lcd = <0x1>;
					cust,esd-check-enable = <0x0>;
					cust,esd-check-mode = <0x0>;
					cust,esd-check-register = <0xa>;
					cust,esd-check-value = <0x9c>;
					cust,fps = <0x3c>;
					cust,height-mm = <0xe2>;
					cust,initial-command = [00 02 30 01 00 05 78 49 61 02 00 00 02 30 02 00 02 31 22 00 02 32 10 00 02 33 36 00 02 3d 42 00 02 3f 61 00 02 42 82 00 02 43 70 00 02 44 21 00 02 49 82 00 02 4a 3f 00 0d 41 00 00 00 00 00 00 0c 0c 00 00 00 00 00 0c 5a 23 23 23 23 23 23 23 19 23 21 20 00 0c 5b 17 15 13 11 0f 0d 0b 09 01 23 23 00 0c 5c 23 23 23 23 23 23 23 18 23 21 20 00 0c 5d 16 14 12 10 0e 0c 0a 08 00 23 23 00 03 4e ff ff 00 03 50 01 01 00 03 55 00 00 00 03 56 00 00 00 04 6f 00 04 00 00 04 70 00 04 00 00 04 71 ff ff 3f 00 04 72 ff ff 3f 00 02 30 05 00 02 31 00 00 04 40 6f 39 39 00 02 30 07 00 02 31 c0 00 02 30 02 00 02 30 08 00 02 40 3d 00 02 41 3d 00 02 42 0f 00 02 47 0a 00 02 48 0c 00 02 4a 17 00 02 4b 1a 00 02 4c a0 00 02 4e a0 00 02 50 0a 00 02 52 83 00 02 5a b0 00 02 5b d0 00 02 5c 74 00 02 62 04 00 02 65 5f 00 02 7e 0f 00 02 5e 00 00 02 73 01 00 02 30 0a 00 02 32 3f 00 02 3f 50 00 02 42 31 00 02 43 00 00 02 49 03 00 02 30 0b 00 03 33 00 54 00 03 3c 00 92 00 02 43 ab 00 02 44 2b 00 06 3e 00 00 08 0d 13 00 0f 3f 1a 30 36 3d 39 56 5e 67 7a 7c 88 95 a5 a3 00 0a 40 50 58 5f 65 00 00 08 0d 13 00 0f 41 1a 30 36 3d 39 56 5e 67 7a 7c 88 95 a5 a3 00 05 42 50 58 70 73 00 02 45 59 00 02 46 45 00 02 48 7e 00 02 49 1f 00 02 4a 1a 00 02 4e 0a 00 02 4f 96 00 02 50 50 00 02 5a 18 00 02 5b 72 00 02 60 13 00 02 61 3f 00 02 67 14 00 02 30 0c 00 02 4a ab 00 02 4b d3 00 02 32 62 00 02 42 34 00 02 5e 00 00 02 6a 7f 00 02 62 41 00 02 30 0d 00 02 4c 74 00 02 30 08 00 02 52 c3 00 02 54 20 00 02 30 08 00 02 30 00 00 02 11 00 00 02 29 00 00 02 35 00 00 02 30 0c 00 02 4a ab 00 02 4b d3 00 02 30 00];
					cust,mipi_dsi_mode_lpm = <0x1>;
					cust,pll_clk = <0x226>;
					cust,power-off-sequence = <0x11 0x0 0x0>;
					cust,rotate = <0x1>;
					cust,sleep-in-command = [0a 01 28 78 01 10 00 02 30 0b 00 02 31 01 00 02 30 00];
					cust,sleep-out-command = [78 01 11 64 01 29];
					cust,ssc_enable = <0x0>;
					cust,width-mm = <0x8d>;
					phandle = <0x6b>;
					use_drm_panel = "dts_lcm_panel";

					display-timings {
						native-mode = <0x42>;

						timing0 {
							clock-frequency = <0x927c000>;
							hactive = <0x4b0>;
							hback-porch = <0x1c>;
							hfront-porch = <0x28>;
							hsync-len = <0x8>;
							phandle = <0x42>;
							vactive = <0x7d0>;
							vback-porch = <0x26>;
							vfront-porch = <0xc8>;
							vsync-len = <0x8>;
						};
					};
				};
			};
		};
	};

	fragment@0 {
		target = <0xffffffff>;

		__overlay__ {

			cam0@0 {
				phandle = <0x2>;

				pins_cmd_dat {
					output-low;
					pinmux = <0x1400>;
					slew-rate = <0x1>;
				};
			};

			cam0@1 {
				phandle = <0x3>;

				pins_cmd_dat {
					output-high;
					pinmux = <0x1400>;
					slew-rate = <0x1>;
				};
			};

			cam0@2 {
				phandle = <0x17>;

				pins_cmd_dat {
					output-low;
					pinmux = <0x1300>;
					slew-rate = <0x1>;
				};
			};

			cam0@3 {
				phandle = <0x18>;

				pins_cmd_dat {
					output-high;
					pinmux = <0x1300>;
					slew-rate = <0x1>;
				};
			};

			cam1@0 {
				phandle = <0x4>;

				pins_cmd_dat {
					output-low;
					pinmux = <0x1000>;
					slew-rate = <0x1>;
				};
			};

			cam1@1 {
				phandle = <0x5>;

				pins_cmd_dat {
					output-high;
					pinmux = <0x1000>;
					slew-rate = <0x1>;
				};
			};

			cam1@2 {
				phandle = <0x19>;

				pins_cmd_dat {
					output-low;
					pinmux = <0x1100>;
					slew-rate = <0x1>;
				};
			};

			cam1@3 {
				phandle = <0x1a>;

				pins_cmd_dat {
					output-high;
					pinmux = <0x1100>;
					slew-rate = <0x1>;
				};
			};

			cam2@0 {
				phandle = <0x6>;

				pins_cmd_dat {
					output-low;
					pinmux = <0x1600>;
					slew-rate = <0x1>;
				};
			};

			cam2@1 {
				phandle = <0x7>;

				pins_cmd_dat {
					output-high;
					pinmux = <0x1600>;
					slew-rate = <0x1>;
				};
			};

			cam2@2 {
				phandle = <0x2b>;

				pins_cmd_dat {
					output-low;
					pinmux = <0x1500>;
					slew-rate = <0x1>;
				};
			};

			cam2@3 {
				phandle = <0x2c>;

				pins_cmd_dat {
					output-high;
					pinmux = <0x1500>;
					slew-rate = <0x1>;
				};
			};

			camdefault {
				phandle = <0x1>;
			};

			camera_pins_cam0_mclk_2ma {
				phandle = <0x9>;

				pins_cmd_dat {
					drive-strength = <0x0>;
					pinmux = <0x8001>;
				};
			};

			camera_pins_cam0_mclk_4ma {
				phandle = <0xa>;

				pins_cmd_dat {
					drive-strength = <0x1>;
					pinmux = <0x8001>;
				};
			};

			camera_pins_cam0_mclk_6ma {
				phandle = <0xb>;

				pins_cmd_dat {
					drive-strength = <0x2>;
					pinmux = <0x8001>;
				};
			};

			camera_pins_cam0_mclk_8ma {
				phandle = <0xc>;

				pins_cmd_dat {
					drive-strength = <0x3>;
					pinmux = <0x8001>;
				};
			};

			camera_pins_cam0_mclk_off {
				phandle = <0x8>;

				pins_cmd_dat {
					drive-strength = <0x1>;
					pinmux = <0x8000>;
				};
			};

			camera_pins_cam1_mclk_2ma {
				phandle = <0xe>;

				pins_cmd_dat {
					drive-strength = <0x0>;
					pinmux = <0x7e01>;
				};
			};

			camera_pins_cam1_mclk_4ma {
				phandle = <0xf>;

				pins_cmd_dat {
					drive-strength = <0x1>;
					pinmux = <0x7e01>;
				};
			};

			camera_pins_cam1_mclk_6ma {
				phandle = <0x10>;

				pins_cmd_dat {
					drive-strength = <0x2>;
					pinmux = <0x7e01>;
				};
			};

			camera_pins_cam1_mclk_8ma {
				phandle = <0x11>;

				pins_cmd_dat {
					drive-strength = <0x3>;
					pinmux = <0x7e01>;
				};
			};

			camera_pins_cam1_mclk_off {
				phandle = <0xd>;

				pins_cmd_dat {
					drive-strength = <0x1>;
					pinmux = <0x7e00>;
				};
			};

			camera_pins_cam2_mclk_2ma {
				phandle = <0x13>;

				pins_cmd_dat {
					drive-strength = <0x0>;
					pinmux = <0x8101>;
				};
			};

			camera_pins_cam2_mclk_4ma {
				phandle = <0x14>;

				pins_cmd_dat {
					drive-strength = <0x1>;
					pinmux = <0x8101>;
				};
			};

			camera_pins_cam2_mclk_6ma {
				phandle = <0x15>;

				pins_cmd_dat {
					drive-strength = <0x2>;
					pinmux = <0x8101>;
				};
			};

			camera_pins_cam2_mclk_8ma {
				phandle = <0x16>;

				pins_cmd_dat {
					drive-strength = <0x3>;
					pinmux = <0x8101>;
				};
			};

			camera_pins_cam2_mclk_off {
				phandle = <0x12>;

				pins_cmd_dat {
					drive-strength = <0x1>;
					pinmux = <0x8100>;
				};
			};

			vcama@0 {
				phandle = <0x1b>;

				pins_cmd_dat {
					output-low;
					pinmux = <0x9d00>;
					slew-rate = <0x1>;
				};
			};

			vcama@1 {
				phandle = <0x1c>;

				pins_cmd_dat {
					output-high;
					pinmux = <0x9d00>;
					slew-rate = <0x1>;
				};
			};

			vcama_1@0 {
				phandle = <0x23>;

				pins_cmd_dat {
					output-low;
					pinmux = <0x9d00>;
					slew-rate = <0x1>;
				};
			};

			vcama_1@1 {
				phandle = <0x24>;

				pins_cmd_dat {
					output-high;
					pinmux = <0x9d00>;
					slew-rate = <0x1>;
				};
			};

			vcama_2@0 {
				phandle = <0x2d>;

				pins_cmd_dat {
					output-low;
					pinmux = <0x9600>;
					slew-rate = <0x1>;
				};
			};

			vcama_2@1 {
				phandle = <0x2e>;

				pins_cmd_dat {
					output-high;
					pinmux = <0x9600>;
					slew-rate = <0x1>;
				};
			};

			vcamaf@0 {
				phandle = <0x21>;

				pins_cmd_dat {
					output-low;
					pinmux = <0x9c00>;
					slew-rate = <0x1>;
				};
			};

			vcamaf@1 {
				phandle = <0x22>;

				pins_cmd_dat {
					output-high;
					pinmux = <0x9c00>;
					slew-rate = <0x1>;
				};
			};

			vcamaf_1@0 {
				phandle = <0x29>;

				pins_cmd_dat {
					output-low;
					pinmux = <0x9c00>;
					slew-rate = <0x1>;
				};
			};

			vcamaf_1@1 {
				phandle = <0x2a>;

				pins_cmd_dat {
					output-high;
					pinmux = <0x9c00>;
					slew-rate = <0x1>;
				};
			};

			vcamaf_2@0 {
				phandle = <0x33>;

				pins_cmd_dat {
					output-low;
					pinmux = <0x9900>;
					slew-rate = <0x1>;
				};
			};

			vcamaf_2@1 {
				phandle = <0x34>;

				pins_cmd_dat {
					output-high;
					pinmux = <0x9900>;
					slew-rate = <0x1>;
				};
			};

			vcamd@0 {
				phandle = <0x1f>;

				pins_cmd_dat {
					output-low;
					pinmux = <0x9e00>;
					slew-rate = <0x1>;
				};
			};

			vcamd@1 {
				phandle = <0x20>;

				pins_cmd_dat {
					output-high;
					pinmux = <0x9e00>;
					slew-rate = <0x1>;
				};
			};

			vcamd_1@0 {
				phandle = <0x27>;

				pins_cmd_dat {
					output-low;
					pinmux = <0x9e00>;
					slew-rate = <0x1>;
				};
			};

			vcamd_1@1 {
				phandle = <0x28>;

				pins_cmd_dat {
					output-high;
					pinmux = <0x9e00>;
					slew-rate = <0x1>;
				};
			};

			vcamd_2@0 {
				phandle = <0x31>;

				pins_cmd_dat {
					output-low;
					pinmux = <0x9700>;
					slew-rate = <0x1>;
				};
			};

			vcamd_2@1 {
				phandle = <0x32>;

				pins_cmd_dat {
					output-high;
					pinmux = <0x9700>;
					slew-rate = <0x1>;
				};
			};

			vcamio@0 {
				phandle = <0x1d>;

				pins_cmd_dat {
					output-low;
					pinmux = <0x9f00>;
					slew-rate = <0x1>;
				};
			};

			vcamio@1 {
				phandle = <0x1e>;

				pins_cmd_dat {
					output-high;
					pinmux = <0x9f00>;
					slew-rate = <0x1>;
				};
			};

			vcamio_1@0 {
				phandle = <0x25>;

				pins_cmd_dat {
					output-low;
					pinmux = <0x9f00>;
					slew-rate = <0x1>;
				};
			};

			vcamio_1@1 {
				phandle = <0x26>;

				pins_cmd_dat {
					output-high;
					pinmux = <0x9f00>;
					slew-rate = <0x1>;
				};
			};

			vcamio_2@0 {
				phandle = <0x2f>;

				pins_cmd_dat {
					output-low;
					pinmux = <0x9f00>;
					slew-rate = <0x1>;
				};
			};

			vcamio_2@1 {
				phandle = <0x30>;

				pins_cmd_dat {
					output-high;
					pinmux = <0x9f00>;
					slew-rate = <0x1>;
				};
			};
		};
	};

	fragment@1 {
		target = <0xffffffff>;

		__overlay__ {
			cam0_pin_mclk = "mclk";
			cam0_pin_pdn = "gpio";
			cam0_pin_rst = "gpio";
			cam0_pin_vcama = "gpio";
			cam0_pin_vcama1 = "gpio";
			cam0_pin_vcamaf = "gpio";
			cam0_pin_vcamd = "gpio";
			cam0_pin_vcamio = "gpio";
			cam1_pin_mclk = "mclk";
			cam1_pin_pdn = "gpio";
			cam1_pin_rst = "gpio";
			cam1_pin_vcama = "gpio";
			cam1_pin_vcama1 = "gpio";
			cam1_pin_vcamaf = "gpio";
			cam1_pin_vcamd = "gpio";
			cam1_pin_vcamio = "gpio";
			cam2_pin_mclk = "mclk";
			cam2_pin_pdn = "gpio";
			cam2_pin_rst = "gpio";
			cam2_pin_vcama = "gpio";
			cam2_pin_vcama1 = "gpio";
			cam2_pin_vcamaf = "gpio";
			cam2_pin_vcamd = "gpio";
			cam2_pin_vcamio = "gpio";
			pinctrl-0 = <0x1>;
			pinctrl-1 = <0x2>;
			pinctrl-10 = <0xb>;
			pinctrl-11 = <0xc>;
			pinctrl-12 = <0xd>;
			pinctrl-13 = <0xe>;
			pinctrl-14 = <0xf>;
			pinctrl-15 = <0x10>;
			pinctrl-16 = <0x11>;
			pinctrl-17 = <0x12>;
			pinctrl-18 = <0x13>;
			pinctrl-19 = <0x14>;
			pinctrl-2 = <0x3>;
			pinctrl-20 = <0x15>;
			pinctrl-21 = <0x16>;
			pinctrl-22 = <0x17>;
			pinctrl-23 = <0x18>;
			pinctrl-24 = <0x19>;
			pinctrl-25 = <0x1a>;
			pinctrl-26 = <0x1b>;
			pinctrl-27 = <0x1c>;
			pinctrl-28 = <0x1d>;
			pinctrl-29 = <0x1e>;
			pinctrl-3 = <0x4>;
			pinctrl-30 = <0x1f>;
			pinctrl-31 = <0x20>;
			pinctrl-32 = <0x21>;
			pinctrl-33 = <0x22>;
			pinctrl-34 = <0x23>;
			pinctrl-35 = <0x24>;
			pinctrl-36 = <0x25>;
			pinctrl-37 = <0x26>;
			pinctrl-38 = <0x27>;
			pinctrl-39 = <0x28>;
			pinctrl-4 = <0x5>;
			pinctrl-40 = <0x29>;
			pinctrl-41 = <0x2a>;
			pinctrl-42 = <0x2b>;
			pinctrl-43 = <0x2c>;
			pinctrl-44 = <0x2d>;
			pinctrl-45 = <0x2e>;
			pinctrl-46 = <0x2f>;
			pinctrl-47 = <0x30>;
			pinctrl-48 = <0x31>;
			pinctrl-49 = <0x32>;
			pinctrl-5 = <0x6>;
			pinctrl-50 = <0x33>;
			pinctrl-51 = <0x34>;
			pinctrl-6 = <0x7>;
			pinctrl-7 = <0x8>;
			pinctrl-8 = <0x9>;
			pinctrl-9 = <0xa>;
			pinctrl-names = "default", "cam0_rst0", "cam0_rst1", "cam1_rst0", "cam1_rst1", "cam2_rst0", "cam2_rst1", "cam0_mclk_off", "cam0_mclk_2mA", "cam0_mclk_4mA", "cam0_mclk_6mA", "cam0_mclk_8mA", "cam1_mclk_off", "cam1_mclk_2mA", "cam1_mclk_4mA", "cam1_mclk_6mA", "cam1_mclk_8mA", "cam2_mclk_off", "cam2_mclk_2mA", "cam2_mclk_4mA", "cam2_mclk_6mA", "cam2_mclk_8mA", "cam0_pnd0", "cam0_pnd1", "cam1_pnd0", "cam1_pnd1", "cam0_ldo_vcama_0", "cam0_ldo_vcama_1", "cam0_ldo_vcamio_0", "cam0_ldo_vcamio_1", "cam0_ldo_vcamd_0", "cam0_ldo_vcamd_1", "cam0_ldo_vcamafvdd_0", "cam0_ldo_vcamafvdd_1", "cam1_ldo_vcama_0", "cam1_ldo_vcama_1", "cam1_ldo_vcamio_0", "cam1_ldo_vcamio_1", "cam1_ldo_vcamd_0", "cam1_ldo_vcamd_1", "cam1_ldo_vcamafvdd_0", "cam1_ldo_vcamafvdd_1", "cam2_pnd0", "cam2_pnd1", "cam2_ldo_vcama_0", "cam2_ldo_vcama_1", "cam2_ldo_vcamio_0", "cam2_ldo_vcamio_1", "cam2_ldo_vcamd_0", "cam2_ldo_vcamd_1", "cam2_ldo_vcamafvdd_0", "cam2_ldo_vcamafvdd_1";
			status = "okay";
		};
	};

	fragment@10 {
		target = <0xffffffff>;

		__overlay__ {
			pinctrl-0 = <0x3c>;
			pinctrl-1 = <0x3d>;
			pinctrl-2 = <0x3e>;
			pinctrl-3 = <0x3f>;
			pinctrl-names = "hwen_high", "hwen_low", "mode_high", "mode_low";
			status = "okay";
		};
	};

	fragment@11 {
		target = <0xffffffff>;

		__overlay__ {
			ACTIVE_TABLE = <0x6>;
			CAR_TUNE_VALUE = <0x65>;
			COM_FG_METER_RESISTANCE = <0x64>;
			COM_R_FG_VALUE = <0x5>;
			DIFFERENCE_FULLOCV_ITH = <0xc8>;
			EMBEDDED_SEL = <0x1>;
			FG_METER_RESISTANCE = <0x46>;
			KEEP_100_PERCENT = <0x2>;
			MULTI_TEMP_GAUGE0 = <0x1>;
			PMIC_MIN_VOL = <0x84d0>;
			PMIC_SHUTDOWN_CURRENT = <0x14>;
			POWERON_SYSTEM_IBOOT = <0x1f4>;
			Q_MAX_SYS_VOLTAGE_BAT0 = <0xd5c>;
			Q_MAX_SYS_VOLTAGE_BAT1 = <0xd5c>;
			Q_MAX_SYS_VOLTAGE_BAT2 = <0xd5c>;
			Q_MAX_SYS_VOLTAGE_BAT3 = <0xd5c>;
			RBAT_PULL_UP_VOLT = <0xaf0>;
			R_FG_VALUE = <0x5>;
			SHUTDOWN_1_TIME = <0x5>;
			SHUTDOWN_GAUGE0_VOLTAGE = <0x86c4>;
			TEMPERATURE_T0 = <0x32>;
			TEMPERATURE_T1 = <0x19>;
			TEMPERATURE_T2 = <0xa>;
			TEMPERATURE_T3 = <0x0>;
			TEMPERATURE_T4 = <0xfffffff9>;
			TEMPERATURE_T5 = <0xfffffff6>;
			UI_LOW_LIMIT_EN = <0x1>;
			UI_LOW_LIMIT_SOC0 = <0xc8>;
			UI_LOW_LIMIT_SOC1 = <0xc8>;
			UI_LOW_LIMIT_SOC2 = <0xc8>;
			UI_LOW_LIMIT_SOC3 = <0xc8>;
			UI_LOW_LIMIT_SOC4 = <0xc8>;
			UI_LOW_LIMIT_VTH0 = <0x87f0>;
			UI_LOW_LIMIT_VTH1 = <0x87f0>;
			UI_LOW_LIMIT_VTH2 = <0x87f0>;
			UI_LOW_LIMIT_VTH3 = <0x87f0>;
			UI_LOW_LIMIT_VTH4 = <0x87f0>;
			battery0_profile_t0 = <0x0 0xa9ba 0x2e4 0x23c 0xa94d 0x2d4 0x478 0xa8dd 0x2c7 0x6b5 0xa84d 0x2cf 0x8f1 0xa7d1 0x2c4 0xb2d 0xa754 0x2bc 0xd69 0xa6d9 0x2bc 0xfa6 0xa667 0x2bf 0x11e2 0xa5f1 0x2c3 0x141e 0xa578 0x2bc 0x165a 0xa506 0x2bc 0x1896 0xa493 0x2bc 0x1ad3 0xa421 0x2c1 0x1d0f 0xa3ae 0x2c6 0x1f4b 0xa341 0x2c6 0x2187 0xa2d3 0x2c6 0x23c4 0xa267 0x2c6 0x2600 0xa1f8 0x2c6 0x283c 0xa18d 0x2cd 0x2a78 0xa125 0x2d8 0x2cb4 0xa0b5 0x2da 0x2ef1 0xa04b 0x2e2 0x312d 0x9fe3 0x2e4 0x3369 0x9f7b 0x2e4 0x35a5 0x9f1d 0x2d1 0x37e2 0x9ede 0x2d1 0x3a1e 0x9eb1 0x304 0x3c5a 0x9e4f 0x323 0x3e96 0x9dba 0x33b 0x40d2 0x9d0b 0x325 0x430f 0x9c6f 0x30a 0x454b 0x9bff 0x2fa 0x4787 0x9ba2 0x2e4 0x49c3 0x9b69 0x2e9 0x4c00 0x9b3a 0x2f9 0x4e3c 0x9b05 0x306 0x5078 0x9ac2 0x311 0x52b4 0x9a6f 0x316 0x54f0 0x9a17 0x316 0x572d 0x99be 0x316 0x5969 0x995a 0x30a 0x5ba5 0x98ec 0x2f5 0x5de1 0x9879 0x2d2 0x601e 0x980e 0x2bf 0x625a 0x97b6 0x2b4 0x6496 0x975a 0x2a2 0x66d2 0x970e 0x295 0x690e 0x96ce 0x28b 0x6b4b 0x9686 0x281 0x6d87 0x9651 0x28a 0x6fc3 0x9613 0x2a8 0x71ff 0x95df 0x2b1 0x743c 0x95ac 0x2a9 0x7678 0x9581 0x2b1 0x78b4 0x954f 0x2a6 0x7af0 0x9525 0x29c 0x7d2c 0x94fe 0x297 0x7f69 0x94dc 0x29b 0x81a5 0x94b2 0x294 0x83e1 0x948c 0x298 0x861d 0x946d 0x29e 0x885a 0x944e 0x29e 0x8a96 0x942f 0x299 0x8cd2 0x9410 0x299 0x8f0e 0x93f0 0x2a4 0x914a 0x93d1 0x2a8 0x9387 0x93b5 0x2af 0x95c3 0x939b 0x2b9 0x97ff 0x937e 0x2bc 0x9a3b 0x935e 0x2c4 0x9c78 0x933f 0x2c6 0x9eb4 0x9320 0x2bd 0xa0f0 0x9301 0x2aa 0xa32c 0x92e2 0x2a8 0xa568 0x92c2 0x2a8 0xa7a5 0x9299 0x2a8 0xa9e1 0x9279 0x2a7 0xac1d 0x9251 0x29f 0xae59 0x9231 0x2aa 0xb096 0x9212 0x2b4 0xb2d2 0x91f1 0x2ba 0xb50e 0x91c4 0x2b2 0xb74a 0x918d 0x2af 0xb986 0x914f 0x2a8 0xbbc3 0x9114 0x2ac 0xbdff 0x90e0 0x2b6 0xc03b 0x90a3 0x2bc 0xc277 0x9055 0x2a2 0xc4b4 0x9018 0x284 0xc6f0 0x9000 0x28c 0xc92c 0x8ff6 0x2a1 0xcb68 0x8feb 0x2b6 0xcda4 0x8fda 0x2d2 0xcfe1 0x8fbd 0x30f 0xd21d 0x8f7e 0x326 0xd459 0x8ea7 0x308 0xd695 0x8d20 0x300 0xd8d2 0x8b24 0x2f0 0xdb0e 0x8883 0x304 0xdd4a 0x84da 0x30e>;
			battery0_profile_t0_col = <0x3>;
			battery0_profile_t0_num = <0x64>;
			battery0_profile_t1 = <0x0 0xa9ba 0x2e4 0x23c 0xa94d 0x2d4 0x478 0xa8dd 0x2c7 0x6b5 0xa84d 0x2cf 0x8f1 0xa7d1 0x2c4 0xb2d 0xa754 0x2bc 0xd69 0xa6d9 0x2bc 0xfa6 0xa667 0x2bf 0x11e2 0xa5f1 0x2c3 0x141e 0xa578 0x2bc 0x165a 0xa506 0x2bc 0x1896 0xa493 0x2bc 0x1ad3 0xa421 0x2c1 0x1d0f 0xa3ae 0x2c6 0x1f4b 0xa341 0x2c6 0x2187 0xa2d3 0x2c6 0x23c4 0xa267 0x2c6 0x2600 0xa1f8 0x2c6 0x283c 0xa18d 0x2cd 0x2a78 0xa125 0x2d8 0x2cb4 0xa0b5 0x2da 0x2ef1 0xa04b 0x2e2 0x312d 0x9fe3 0x2e4 0x3369 0x9f7b 0x2e4 0x35a5 0x9f1d 0x2d1 0x37e2 0x9ede 0x2d1 0x3a1e 0x9eb1 0x304 0x3c5a 0x9e4f 0x323 0x3e96 0x9dba 0x33b 0x40d2 0x9d0b 0x325 0x430f 0x9c6f 0x30a 0x454b 0x9bff 0x2fa 0x4787 0x9ba2 0x2e4 0x49c3 0x9b69 0x2e9 0x4c00 0x9b3a 0x2f9 0x4e3c 0x9b05 0x306 0x5078 0x9ac2 0x311 0x52b4 0x9a6f 0x316 0x54f0 0x9a17 0x316 0x572d 0x99be 0x316 0x5969 0x995a 0x30a 0x5ba5 0x98ec 0x2f5 0x5de1 0x9879 0x2d2 0x601e 0x980e 0x2bf 0x625a 0x97b6 0x2b4 0x6496 0x975a 0x2a2 0x66d2 0x970e 0x295 0x690e 0x96ce 0x28b 0x6b4b 0x9686 0x281 0x6d87 0x9651 0x28a 0x6fc3 0x9613 0x2a8 0x71ff 0x95df 0x2b1 0x743c 0x95ac 0x2a9 0x7678 0x9581 0x2b1 0x78b4 0x954f 0x2a6 0x7af0 0x9525 0x29c 0x7d2c 0x94fe 0x297 0x7f69 0x94dc 0x29b 0x81a5 0x94b2 0x294 0x83e1 0x948c 0x298 0x861d 0x946d 0x29e 0x885a 0x944e 0x29e 0x8a96 0x942f 0x299 0x8cd2 0x9410 0x299 0x8f0e 0x93f0 0x2a4 0x914a 0x93d1 0x2a8 0x9387 0x93b5 0x2af 0x95c3 0x939b 0x2b9 0x97ff 0x937e 0x2bc 0x9a3b 0x935e 0x2c4 0x9c78 0x933f 0x2c6 0x9eb4 0x9320 0x2bd 0xa0f0 0x9301 0x2aa 0xa32c 0x92e2 0x2a8 0xa568 0x92c2 0x2a8 0xa7a5 0x9299 0x2a8 0xa9e1 0x9279 0x2a7 0xac1d 0x9251 0x29f 0xae59 0x9231 0x2aa 0xb096 0x9212 0x2b4 0xb2d2 0x91f1 0x2ba 0xb50e 0x91c4 0x2b2 0xb74a 0x918d 0x2af 0xb986 0x914f 0x2a8 0xbbc3 0x9114 0x2ac 0xbdff 0x90e0 0x2b6 0xc03b 0x90a3 0x2bc 0xc277 0x9055 0x2a2 0xc4b4 0x9018 0x284 0xc6f0 0x9000 0x28c 0xc92c 0x8ff6 0x2a1 0xcb68 0x8feb 0x2b6 0xcda4 0x8fda 0x2d2 0xcfe1 0x8fbd 0x30f 0xd21d 0x8f7e 0x326 0xd459 0x8ea7 0x308 0xd695 0x8d20 0x300 0xd8d2 0x8b24 0x2f0 0xdb0e 0x8883 0x304 0xdd4a 0x84da 0x30e>;
			battery0_profile_t1_col = <0x3>;
			battery0_profile_t1_num = <0x64>;
			battery0_profile_t2 = <0x0 0xa9ba 0x2e4 0x23c 0xa94d 0x2d4 0x478 0xa8dd 0x2c7 0x6b5 0xa84d 0x2cf 0x8f1 0xa7d1 0x2c4 0xb2d 0xa754 0x2bc 0xd69 0xa6d9 0x2bc 0xfa6 0xa667 0x2bf 0x11e2 0xa5f1 0x2c3 0x141e 0xa578 0x2bc 0x165a 0xa506 0x2bc 0x1896 0xa493 0x2bc 0x1ad3 0xa421 0x2c1 0x1d0f 0xa3ae 0x2c6 0x1f4b 0xa341 0x2c6 0x2187 0xa2d3 0x2c6 0x23c4 0xa267 0x2c6 0x2600 0xa1f8 0x2c6 0x283c 0xa18d 0x2cd 0x2a78 0xa125 0x2d8 0x2cb4 0xa0b5 0x2da 0x2ef1 0xa04b 0x2e2 0x312d 0x9fe3 0x2e4 0x3369 0x9f7b 0x2e4 0x35a5 0x9f1d 0x2d1 0x37e2 0x9ede 0x2d1 0x3a1e 0x9eb1 0x304 0x3c5a 0x9e4f 0x323 0x3e96 0x9dba 0x33b 0x40d2 0x9d0b 0x325 0x430f 0x9c6f 0x30a 0x454b 0x9bff 0x2fa 0x4787 0x9ba2 0x2e4 0x49c3 0x9b69 0x2e9 0x4c00 0x9b3a 0x2f9 0x4e3c 0x9b05 0x306 0x5078 0x9ac2 0x311 0x52b4 0x9a6f 0x316 0x54f0 0x9a17 0x316 0x572d 0x99be 0x316 0x5969 0x995a 0x30a 0x5ba5 0x98ec 0x2f5 0x5de1 0x9879 0x2d2 0x601e 0x980e 0x2bf 0x625a 0x97b6 0x2b4 0x6496 0x975a 0x2a2 0x66d2 0x970e 0x295 0x690e 0x96ce 0x28b 0x6b4b 0x9686 0x281 0x6d87 0x9651 0x28a 0x6fc3 0x9613 0x2a8 0x71ff 0x95df 0x2b1 0x743c 0x95ac 0x2a9 0x7678 0x9581 0x2b1 0x78b4 0x954f 0x2a6 0x7af0 0x9525 0x29c 0x7d2c 0x94fe 0x297 0x7f69 0x94dc 0x29b 0x81a5 0x94b2 0x294 0x83e1 0x948c 0x298 0x861d 0x946d 0x29e 0x885a 0x944e 0x29e 0x8a96 0x942f 0x299 0x8cd2 0x9410 0x299 0x8f0e 0x93f0 0x2a4 0x914a 0x93d1 0x2a8 0x9387 0x93b5 0x2af 0x95c3 0x939b 0x2b9 0x97ff 0x937e 0x2bc 0x9a3b 0x935e 0x2c4 0x9c78 0x933f 0x2c6 0x9eb4 0x9320 0x2bd 0xa0f0 0x9301 0x2aa 0xa32c 0x92e2 0x2a8 0xa568 0x92c2 0x2a8 0xa7a5 0x9299 0x2a8 0xa9e1 0x9279 0x2a7 0xac1d 0x9251 0x29f 0xae59 0x9231 0x2aa 0xb096 0x9212 0x2b4 0xb2d2 0x91f1 0x2ba 0xb50e 0x91c4 0x2b2 0xb74a 0x918d 0x2af 0xb986 0x914f 0x2a8 0xbbc3 0x9114 0x2ac 0xbdff 0x90e0 0x2b6 0xc03b 0x90a3 0x2bc 0xc277 0x9055 0x2a2 0xc4b4 0x9018 0x284 0xc6f0 0x9000 0x28c 0xc92c 0x8ff6 0x2a1 0xcb68 0x8feb 0x2b6 0xcda4 0x8fda 0x2d2 0xcfe1 0x8fbd 0x30f 0xd21d 0x8f7e 0x326 0xd459 0x8ea7 0x308 0xd695 0x8d20 0x300 0xd8d2 0x8b24 0x2f0 0xdb0e 0x8883 0x304 0xdd4a 0x84da 0x30e>;
			battery0_profile_t2_col = <0x3>;
			battery0_profile_t2_num = <0x64>;
			battery0_profile_t3 = <0x0 0xa9ba 0x2e4 0x23c 0xa94d 0x2d4 0x478 0xa8dd 0x2c7 0x6b5 0xa84d 0x2cf 0x8f1 0xa7d1 0x2c4 0xb2d 0xa754 0x2bc 0xd69 0xa6d9 0x2bc 0xfa6 0xa667 0x2bf 0x11e2 0xa5f1 0x2c3 0x141e 0xa578 0x2bc 0x165a 0xa506 0x2bc 0x1896 0xa493 0x2bc 0x1ad3 0xa421 0x2c1 0x1d0f 0xa3ae 0x2c6 0x1f4b 0xa341 0x2c6 0x2187 0xa2d3 0x2c6 0x23c4 0xa267 0x2c6 0x2600 0xa1f8 0x2c6 0x283c 0xa18d 0x2cd 0x2a78 0xa125 0x2d8 0x2cb4 0xa0b5 0x2da 0x2ef1 0xa04b 0x2e2 0x312d 0x9fe3 0x2e4 0x3369 0x9f7b 0x2e4 0x35a5 0x9f1d 0x2d1 0x37e2 0x9ede 0x2d1 0x3a1e 0x9eb1 0x304 0x3c5a 0x9e4f 0x323 0x3e96 0x9dba 0x33b 0x40d2 0x9d0b 0x325 0x430f 0x9c6f 0x30a 0x454b 0x9bff 0x2fa 0x4787 0x9ba2 0x2e4 0x49c3 0x9b69 0x2e9 0x4c00 0x9b3a 0x2f9 0x4e3c 0x9b05 0x306 0x5078 0x9ac2 0x311 0x52b4 0x9a6f 0x316 0x54f0 0x9a17 0x316 0x572d 0x99be 0x316 0x5969 0x995a 0x30a 0x5ba5 0x98ec 0x2f5 0x5de1 0x9879 0x2d2 0x601e 0x980e 0x2bf 0x625a 0x97b6 0x2b4 0x6496 0x975a 0x2a2 0x66d2 0x970e 0x295 0x690e 0x96ce 0x28b 0x6b4b 0x9686 0x281 0x6d87 0x9651 0x28a 0x6fc3 0x9613 0x2a8 0x71ff 0x95df 0x2b1 0x743c 0x95ac 0x2a9 0x7678 0x9581 0x2b1 0x78b4 0x954f 0x2a6 0x7af0 0x9525 0x29c 0x7d2c 0x94fe 0x297 0x7f69 0x94dc 0x29b 0x81a5 0x94b2 0x294 0x83e1 0x948c 0x298 0x861d 0x946d 0x29e 0x885a 0x944e 0x29e 0x8a96 0x942f 0x299 0x8cd2 0x9410 0x299 0x8f0e 0x93f0 0x2a4 0x914a 0x93d1 0x2a8 0x9387 0x93b5 0x2af 0x95c3 0x939b 0x2b9 0x97ff 0x937e 0x2bc 0x9a3b 0x935e 0x2c4 0x9c78 0x933f 0x2c6 0x9eb4 0x9320 0x2bd 0xa0f0 0x9301 0x2aa 0xa32c 0x92e2 0x2a8 0xa568 0x92c2 0x2a8 0xa7a5 0x9299 0x2a8 0xa9e1 0x9279 0x2a7 0xac1d 0x9251 0x29f 0xae59 0x9231 0x2aa 0xb096 0x9212 0x2b4 0xb2d2 0x91f1 0x2ba 0xb50e 0x91c4 0x2b2 0xb74a 0x918d 0x2af 0xb986 0x914f 0x2a8 0xbbc3 0x9114 0x2ac 0xbdff 0x90e0 0x2b6 0xc03b 0x90a3 0x2bc 0xc277 0x9055 0x2a2 0xc4b4 0x9018 0x284 0xc6f0 0x9000 0x28c 0xc92c 0x8ff6 0x2a1 0xcb68 0x8feb 0x2b6 0xcda4 0x8fda 0x2d2 0xcfe1 0x8fbd 0x30f 0xd21d 0x8f7e 0x326 0xd459 0x8ea7 0x308 0xd695 0x8d20 0x300 0xd8d2 0x8b24 0x2f0 0xdb0e 0x8883 0x304 0xdd4a 0x84da 0x30e>;
			battery0_profile_t3_col = <0x3>;
			battery0_profile_t3_num = <0x64>;
			battery0_profile_t4 = <0x0 0xa9ba 0x2e4 0x23c 0xa94d 0x2d4 0x478 0xa8dd 0x2c7 0x6b5 0xa84d 0x2cf 0x8f1 0xa7d1 0x2c4 0xb2d 0xa754 0x2bc 0xd69 0xa6d9 0x2bc 0xfa6 0xa667 0x2bf 0x11e2 0xa5f1 0x2c3 0x141e 0xa578 0x2bc 0x165a 0xa506 0x2bc 0x1896 0xa493 0x2bc 0x1ad3 0xa421 0x2c1 0x1d0f 0xa3ae 0x2c6 0x1f4b 0xa341 0x2c6 0x2187 0xa2d3 0x2c6 0x23c4 0xa267 0x2c6 0x2600 0xa1f8 0x2c6 0x283c 0xa18d 0x2cd 0x2a78 0xa125 0x2d8 0x2cb4 0xa0b5 0x2da 0x2ef1 0xa04b 0x2e2 0x312d 0x9fe3 0x2e4 0x3369 0x9f7b 0x2e4 0x35a5 0x9f1d 0x2d1 0x37e2 0x9ede 0x2d1 0x3a1e 0x9eb1 0x304 0x3c5a 0x9e4f 0x323 0x3e96 0x9dba 0x33b 0x40d2 0x9d0b 0x325 0x430f 0x9c6f 0x30a 0x454b 0x9bff 0x2fa 0x4787 0x9ba2 0x2e4 0x49c3 0x9b69 0x2e9 0x4c00 0x9b3a 0x2f9 0x4e3c 0x9b05 0x306 0x5078 0x9ac2 0x311 0x52b4 0x9a6f 0x316 0x54f0 0x9a17 0x316 0x572d 0x99be 0x316 0x5969 0x995a 0x30a 0x5ba5 0x98ec 0x2f5 0x5de1 0x9879 0x2d2 0x601e 0x980e 0x2bf 0x625a 0x97b6 0x2b4 0x6496 0x975a 0x2a2 0x66d2 0x970e 0x295 0x690e 0x96ce 0x28b 0x6b4b 0x9686 0x281 0x6d87 0x9651 0x28a 0x6fc3 0x9613 0x2a8 0x71ff 0x95df 0x2b1 0x743c 0x95ac 0x2a9 0x7678 0x9581 0x2b1 0x78b4 0x954f 0x2a6 0x7af0 0x9525 0x29c 0x7d2c 0x94fe 0x297 0x7f69 0x94dc 0x29b 0x81a5 0x94b2 0x294 0x83e1 0x948c 0x298 0x861d 0x946d 0x29e 0x885a 0x944e 0x29e 0x8a96 0x942f 0x299 0x8cd2 0x9410 0x299 0x8f0e 0x93f0 0x2a4 0x914a 0x93d1 0x2a8 0x9387 0x93b5 0x2af 0x95c3 0x939b 0x2b9 0x97ff 0x937e 0x2bc 0x9a3b 0x935e 0x2c4 0x9c78 0x933f 0x2c6 0x9eb4 0x9320 0x2bd 0xa0f0 0x9301 0x2aa 0xa32c 0x92e2 0x2a8 0xa568 0x92c2 0x2a8 0xa7a5 0x9299 0x2a8 0xa9e1 0x9279 0x2a7 0xac1d 0x9251 0x29f 0xae59 0x9231 0x2aa 0xb096 0x9212 0x2b4 0xb2d2 0x91f1 0x2ba 0xb50e 0x91c4 0x2b2 0xb74a 0x918d 0x2af 0xb986 0x914f 0x2a8 0xbbc3 0x9114 0x2ac 0xbdff 0x90e0 0x2b6 0xc03b 0x90a3 0x2bc 0xc277 0x9055 0x2a2 0xc4b4 0x9018 0x284 0xc6f0 0x9000 0x28c 0xc92c 0x8ff6 0x2a1 0xcb68 0x8feb 0x2b6 0xcda4 0x8fda 0x2d2 0xcfe1 0x8fbd 0x30f 0xd21d 0x8f7e 0x326 0xd459 0x8ea7 0x308 0xd695 0x8d20 0x300 0xd8d2 0x8b24 0x2f0 0xdb0e 0x8883 0x304 0xdd4a 0x84da 0x30e>;
			battery0_profile_t4_col = <0x3>;
			battery0_profile_t4_num = <0x64>;
			battery0_profile_t5 = <0x0 0xa9ba 0x2e4 0x23c 0xa94d 0x2d4 0x478 0xa8dd 0x2c7 0x6b5 0xa84d 0x2cf 0x8f1 0xa7d1 0x2c4 0xb2d 0xa754 0x2bc 0xd69 0xa6d9 0x2bc 0xfa6 0xa667 0x2bf 0x11e2 0xa5f1 0x2c3 0x141e 0xa578 0x2bc 0x165a 0xa506 0x2bc 0x1896 0xa493 0x2bc 0x1ad3 0xa421 0x2c1 0x1d0f 0xa3ae 0x2c6 0x1f4b 0xa341 0x2c6 0x2187 0xa2d3 0x2c6 0x23c4 0xa267 0x2c6 0x2600 0xa1f8 0x2c6 0x283c 0xa18d 0x2cd 0x2a78 0xa125 0x2d8 0x2cb4 0xa0b5 0x2da 0x2ef1 0xa04b 0x2e2 0x312d 0x9fe3 0x2e4 0x3369 0x9f7b 0x2e4 0x35a5 0x9f1d 0x2d1 0x37e2 0x9ede 0x2d1 0x3a1e 0x9eb1 0x304 0x3c5a 0x9e4f 0x323 0x3e96 0x9dba 0x33b 0x40d2 0x9d0b 0x325 0x430f 0x9c6f 0x30a 0x454b 0x9bff 0x2fa 0x4787 0x9ba2 0x2e4 0x49c3 0x9b69 0x2e9 0x4c00 0x9b3a 0x2f9 0x4e3c 0x9b05 0x306 0x5078 0x9ac2 0x311 0x52b4 0x9a6f 0x316 0x54f0 0x9a17 0x316 0x572d 0x99be 0x316 0x5969 0x995a 0x30a 0x5ba5 0x98ec 0x2f5 0x5de1 0x9879 0x2d2 0x601e 0x980e 0x2bf 0x625a 0x97b6 0x2b4 0x6496 0x975a 0x2a2 0x66d2 0x970e 0x295 0x690e 0x96ce 0x28b 0x6b4b 0x9686 0x281 0x6d87 0x9651 0x28a 0x6fc3 0x9613 0x2a8 0x71ff 0x95df 0x2b1 0x743c 0x95ac 0x2a9 0x7678 0x9581 0x2b1 0x78b4 0x954f 0x2a6 0x7af0 0x9525 0x29c 0x7d2c 0x94fe 0x297 0x7f69 0x94dc 0x29b 0x81a5 0x94b2 0x294 0x83e1 0x948c 0x298 0x861d 0x946d 0x29e 0x885a 0x944e 0x29e 0x8a96 0x942f 0x299 0x8cd2 0x9410 0x299 0x8f0e 0x93f0 0x2a4 0x914a 0x93d1 0x2a8 0x9387 0x93b5 0x2af 0x95c3 0x939b 0x2b9 0x97ff 0x937e 0x2bc 0x9a3b 0x935e 0x2c4 0x9c78 0x933f 0x2c6 0x9eb4 0x9320 0x2bd 0xa0f0 0x9301 0x2aa 0xa32c 0x92e2 0x2a8 0xa568 0x92c2 0x2a8 0xa7a5 0x9299 0x2a8 0xa9e1 0x9279 0x2a7 0xac1d 0x9251 0x29f 0xae59 0x9231 0x2aa 0xb096 0x9212 0x2b4 0xb2d2 0x91f1 0x2ba 0xb50e 0x91c4 0x2b2 0xb74a 0x918d 0x2af 0xb986 0x914f 0x2a8 0xbbc3 0x9114 0x2ac 0xbdff 0x90e0 0x2b6 0xc03b 0x90a3 0x2bc 0xc277 0x9055 0x2a2 0xc4b4 0x9018 0x284 0xc6f0 0x9000 0x28c 0xc92c 0x8ff6 0x2a1 0xcb68 0x8feb 0x2b6 0xcda4 0x8fda 0x2d2 0xcfe1 0x8fbd 0x30f 0xd21d 0x8f7e 0x326 0xd459 0x8ea7 0x308 0xd695 0x8d20 0x300 0xd8d2 0x8b24 0x2f0 0xdb0e 0x8883 0x304 0xdd4a 0x84da 0x30e>;
			battery0_profile_t5_col = <0x3>;
			battery0_profile_t5_num = <0x64>;
			enable_tmp_intr_suspend = <0x0>;
			g_FG_PSEUDO100 = <0x64 0x64 0x64 0x64 0x64 0x64 0x64 0x64 0x64 0x64 0x64 0x64 0x64 0x64 0x64 0x64 0x64 0x64 0x64 0x64 0x64 0x64 0x64 0x64 0x64 0x64 0x64 0x64 0x64 0x64 0x64 0x64 0x64 0x64 0x64 0x64 0x64 0x64 0x64 0x64>;
			g_FG_PSEUDO100_T0 = <0x64>;
			g_FG_PSEUDO100_T1 = <0x64>;
			g_FG_PSEUDO100_T2 = <0x64>;
			g_FG_PSEUDO100_T3 = <0x64>;
			g_FG_PSEUDO100_T4 = <0x64>;
			g_FG_PSEUDO100_col = <0xa>;
			g_FG_PSEUDO100_row = <0x4>;
			g_FG_charge_PSEUDO100 = <0x64 0x64 0x64 0x64 0x64 0x64 0x64 0x64 0x64 0x64 0x64 0x64 0x64 0x64 0x64 0x64 0x64 0x64 0x64 0x64 0x64 0x64 0x64 0x64 0x64 0x64 0x64 0x64 0x64 0x64 0x64 0x64 0x64 0x64 0x64 0x64 0x64 0x64 0x64 0x64>;
			g_FG_charge_PSEUDO100_col = <0xa>;
			g_FG_charge_PSEUDO100_row = <0x4>;
			g_PMIC_MIN_VOL = <0x84d0 0x84d0 0x84d0 0x84d0 0x84d0 0x84d0 0x84d0 0x84d0 0x84d0 0x84d0 0x84d0 0x84d0 0x84d0 0x84d0 0x84d0 0x84d0 0x84d0 0x84d0 0x84d0 0x84d0 0x84d0 0x84d0 0x84d0 0x84d0 0x84d0 0x84d0 0x84d0 0x84d0 0x84d0 0x84d0 0x84d0 0x84d0 0x84d0 0x84d0 0x84d0 0x84d0 0x84d0 0x84d0 0x84d0 0x84d0>;
			g_PMIC_MIN_VOL_col = <0xa>;
			g_PMIC_MIN_VOL_row = <0x4>;
			g_PON_SYS_IBOOT = <0x1388 0x1388 0x1388 0x1388 0x1388 0x1388 0x1388 0x1388 0x1388 0x1388 0x1388 0x1388 0x1388 0x1388 0x1388 0x1388 0x1388 0x1388 0x1388 0x1388 0x1388 0x1388 0x1388 0x1388 0x1388 0x1388 0x1388 0x1388 0x1388 0x1388 0x1388 0x1388 0x1388 0x1388 0x1388 0x1388 0x1388 0x1388 0x1388 0x1388>;
			g_PON_SYS_IBOOT_col = <0xa>;
			g_PON_SYS_IBOOT_row = <0x4>;
			g_QMAX_SYS_VOL = <0x85ca 0x85ca 0x85ca 0x85ca 0x85ca 0x85ca 0x85ca 0x85ca 0x85ca 0x85ca 0x85ca 0x85ca 0x85ca 0x85ca 0x85ca 0x85ca 0x85ca 0x85ca 0x85ca 0x85ca 0x85ca 0x85ca 0x85ca 0x85ca 0x85ca 0x85ca 0x85ca 0x85ca 0x85ca 0x85ca 0x85ca 0x85ca 0x85ca 0x85ca 0x85ca 0x85ca 0x85ca 0x85ca 0x85ca 0x85ca>;
			g_QMAX_SYS_VOL_col = <0xa>;
			g_QMAX_SYS_VOL_row = <0x4>;
			g_SHUTDOWN_HL_ZCV = <0xd48 0xd48 0xd48 0xd48 0xd48 0xd48 0xd48 0xd48 0xd48 0xd48 0xd48 0xd48 0xd48 0xd48 0xd48 0xd48 0xd48 0xd48 0xd48 0xd48>;
		};
	};

	fragment@12 {
		target = <0xffffffff>;

		__overlay__ {

			MTEE {
				alignment = <0x0 0x100000>;
				no-map;
				size = <0x0 0x100000>;
			};

			SecureVideoPath {
				compatible = "mediatek,mtk_sec_video_path_support";
			};

			tkcore_shared_mem {
				alignment = <0x0 0x1000>;
				alloc-ranges = <0x0 0x40000000 0x0 0x80000000>;
				compatible = "trustkernel,shared_mem";
				no-map;
				size = <0x0 0x1000000>;
			};
		};
	};

	fragment@13 {
		target = <0xffffffff>;

		__overlay__ {
		};
	};

	fragment@14 {
		target = <0xffffffff>;

		__overlay__ {
			hardware = "mt8781";
		};
	};

	fragment@15 {
		target = <0xffffffff>;

		__overlay__ {
			compatible = "mediatek,pwm-leds";

			backlight {
				gate_enable = <0x1>;
				led_mode = <0x5>;
				pwm_config = <0x0 0x1 0x0 0x0 0x0>;
				pwms = <0xffffffff 0x0 0x99d9>;
			};
		};
	};

	fragment@16 {
		target = <0xffffffff>;

		__overlay__ {

			lcd_bias_enn0_gpio {
				phandle = <0x46>;

				pins_cmd_dat {
					output-low;
					pinmux = <0x2700>;
					slew-rate = <0x1>;
				};
			};

			lcd_bias_enn1_gpio {
				phandle = <0x45>;

				pins_cmd_dat {
					output-high;
					pinmux = <0x2700>;
					slew-rate = <0x1>;
				};
			};

			lcd_bias_enp0_gpio {
				phandle = <0x44>;

				pins_cmd_dat {
					output-low;
					pinmux = <0x2600>;
					slew-rate = <0x1>;
				};
			};

			lcd_bias_enp1_gpio {
				phandle = <0x43>;

				pins_cmd_dat {
					output-high;
					pinmux = <0x2600>;
					slew-rate = <0x1>;
				};
			};

			lcd_pwr_1v8_en_gpio {
				phandle = <0x4c>;
			};

			lcd_pwr_3v3_en_gpio {
				phandle = <0x4d>;
			};

			lcm_dsi_te {
				phandle = <0x4b>;

				pins_cmd_dat {
					pinmux = <0x5301>;
				};
			};

			lcm_led_en0_gpio {
				phandle = <0x48>;

				pins_cmd_dat {
					output-low;
					pinmux = <0x5f00>;
					slew-rate = <0x1>;
				};
			};

			lcm_led_en1_gpio {
				phandle = <0x47>;

				pins_cmd_dat {
					output-high;
					pinmux = <0x5f00>;
					slew-rate = <0x1>;
				};
			};

			lcm_rst_out0_gpio {
				phandle = <0x4a>;

				pins_cmd_dat {
					output-low;
					pinmux = <0x5500>;
					slew-rate = <0x1>;
				};
			};

			lcm_rst_out1_gpio {
				phandle = <0x49>;

				pins_cmd_dat {
					output-high;
					pinmux = <0x5500>;
					slew-rate = <0x1>;
				};
			};

			tp_rst_gpio {
				phandle = <0x4e>;
			};
		};
	};

	fragment@17 {
		target = <0xffffffff>;

		__overlay__ {
			pinctrl-0 = <0x43>;
			pinctrl-1 = <0x44>;
			pinctrl-10 = <0x4d>;
			pinctrl-11 = <0x4e>;
			pinctrl-2 = <0x45>;
			pinctrl-3 = <0x46>;
			pinctrl-4 = <0x47>;
			pinctrl-5 = <0x48>;
			pinctrl-6 = <0x49>;
			pinctrl-7 = <0x4a>;
			pinctrl-8 = <0x4b>;
			pinctrl-9 = <0x4c>;
			pinctrl-names = "lcd_bias_enp1_gpio", "lcd_bias_enp0_gpio", "lcd_bias_enn1_gpio", "lcd_bias_enn0_gpio", "lcm_led_en1_gpio", "lcm_led_en0_gpio", "lcm_rst_out1_gpio", "lcm_rst_out0_gpio", "mode_te_te", "lcd_pwr_1v8_en_gpio", "lcd_pwr_3v3_en_gpio", "tp_rst_gpio";
			status = "okay";
		};
	};

	fragment@18 {
		target = <0xffffffff>;

		__overlay__ {
			pinctrl-0 = <0x49>;
			pinctrl-1 = <0x4a>;
			pinctrl-2 = <0x4b>;
			pinctrl-names = "lcm_rst_out1_gpio", "lcm_rst_out0_gpio", "mode_te_te";
			status = "okay";
		};
	};

	fragment@19 {
		target = <0xffffffff>;

		__overlay__ {
			#address-cells = <0x1>;
			#size-cells = <0x0>;
			status = "okay";

			panel1@0 {
				compatible = "wb,drm_lcm";
				pinctrl-names = "default";
				reg = <0x0>;

				port {

					endpoint {
						phandle = <0x50>;
						remote-endpoint = <0x4f>;
					};
				};
			};

			ports {

				port {

					endpoint {
						phandle = <0x4f>;
						remote-endpoint = <0x50>;
					};
				};
			};
		};
	};

	fragment@2 {
		target = <0xffffffff>;

		__overlay__ {
			#address-cells = <0x1>;
			#size-cells = <0x0>;
			clock-frequency = <0x61a80>;
			status = "okay";

			camera_eeprom2@51 {
				compatible = "mediatek,camera_eeprom";
				phandle = <0x5f>;
				reg = <0x51>;
				status = "okay";
			};

			camera_main_three_af@0c {
				compatible = "mediatek,camera_main_three_af";
				phandle = <0x61>;
				reg = <0xc>;
				status = "okay";
			};

			camera_main_two@10 {
				#thermal-sensor-cells = <0x0>;
				compatible = "mediatek,camera_main_two";
				phandle = <0x37>;
				reg = <0x10>;
				status = "okay";
			};

			camera_main_two_af@0d {
				compatible = "mediatek,camera_main_two_af";
				phandle = <0x60>;
				reg = <0xd>;
				status = "okay";
			};
		};
	};

	fragment@20 {
		target = <0xffffffff>;

		__overlay__ {

			gpio-keys {
				compatible = "gpio-keys";
				phandle = <0x6c>;

				lid {
					gpio-key,wakeup;
					gpios = <0xffffffff 0x0 0x1>;
					label = "Lid";
					linux,code = <0x0>;
					linux,input-type = <0x5>;
				};
			};
		};
	};

	fragment@21 {
		target = <0xffffffff>;

		__overlay__ {

			gps_default {
				phandle = <0x51>;
			};

			gps_l1_lna@0 {
				phandle = <0x52>;

				pins_cmd_dat {
					output-low;
					pinmux = <0x1900>;
				};
			};

			gps_l1_lna@1 {
				phandle = <0x53>;

				pins_cmd_dat {
					pinmux = <0x1902>;
				};
			};

			gps_l1_lna@2 {
				phandle = <0x54>;

				pins_cmd_dat {
					output-high;
					pinmux = <0x1900>;
				};
			};

			gps_l5_lna@0 {
				phandle = <0x55>;

				pins_cmd_dat {
					output-low;
					pinmux = <0x1a00>;
				};
			};

			gps_l5_lna@1 {
				phandle = <0x56>;

				pins_cmd_dat {
					pinmux = <0x1a02>;
				};
			};

			gps_l5_lna@2 {
				phandle = <0x57>;

				pins_cmd_dat {
					output-high;
					pinmux = <0x1a00>;
				};
			};
		};
	};

	fragment@22 {
		target = <0xffffffff>;

		__overlay__ {
			compatible = "cust,cust_gpios";
			gpio_bias_en = <0xffffffff 0x5f 0x0>;
			gpio_bias_neg = <0xffffffff 0x27 0x0>;
			gpio_bias_pos = <0xffffffff 0x26 0x0>;
			gpio_lcm_1v8 = <0xffffffff 0x23 0x0>;
			gpio_lcm_3v3 = <0xffffffff 0x22 0x0>;
			gpio_lcm_rst = <0xffffffff 0x55 0x0>;
			gpio_usb_hp_sw = <0xffffffff 0x25 0x0>;
			status = "okay";
		};
	};

	fragment@23 {
		target = <0xffffffff>;

		__overlay__ {
			pinctrl-0 = <0x51>;
			pinctrl-1 = <0x52>;
			pinctrl-2 = <0x53>;
			pinctrl-3 = <0x54>;
			pinctrl-4 = <0x55>;
			pinctrl-5 = <0x56>;
			pinctrl-6 = <0x57>;
			pinctrl-names = "default", "gps_l1_lna_disable", "gps_l1_lna_dsp_ctrl", "gps_l1_lna_enable", "gps_l5_lna_disable", "gps_l5_lna_dsp_ctrl", "gps_l5_lna_enable";
			status = "okay";
		};
	};

	fragment@24 {
		target = <0xffffffff>;

		__overlay__ {
			pinctrl-0 = <0x58>;
			pinctrl-names = "default";
			status = "okay";

			himax@0 {
				compatible = "himax,hxcommon";
				himax,display-coords = <0x0 0x4b0 0x0 0x7d0>;
				himax,irq-gpio = <0xffffffff 0x9 0x0>;
				himax,panel-coords = <0x0 0x4b0 0x0 0x7d0>;
				himax,rst-gpio = <0xffffffff 0x98 0x0>;
				interrupt-parent = <0xffffffff>;
				pinctrl-0 = <0x59>;
				pinctrl-1 = <0x5a>;
				pinctrl-names = "spi_pull_down", "spi_pull_up";
				reg = <0x0>;
				report_type = <0x1>;
				spi-cpha;
				spi-max-frequency = <0x927c00>;
				status = "ok";
			};
		};
	};

	fragment@25 {
		target = <0xffffffff>;

		__overlay__ {

			spi0@1 {
				phandle = <0x58>;

				pins_cmd_dat {
					drive-strength = <0x2>;
					pinmux = <0x1e01 0x2001 0x2101>;
				};
			};

			spi_pull_down_ctrl {
				phandle = <0x59>;

				pins_cmd_dat {
					output-low;
					pinmux = <0x1f00>;
				};
			};

			spi_pull_up_ctrl {
				phandle = <0x5a>;

				pins_cmd_dat {
					drive-strength = <0x2>;
					pinmux = <0x1f01>;
				};
			};
		};
	};

	fragment@26 {
		target = <0xffffffff>;

		__overlay__ {
			status = "okay";

			focaltech@0 {
				compatible = "focaltech,fts";
				focaltech,display-coords = <0x0 0x0 0x4b0 0x7d0>;
				focaltech,irq-gpio = <0xffffffff 0x9 0x0>;
				focaltech,max-touch-number = <0xa>;
				focaltech,reset-gpio = <0xffffffff 0x98 0x0>;
				pinctrl-0 = <0x5b>;
				pinctrl-1 = <0x5c>;
				pinctrl-names = "fts_spi0_cs_pull_down", "fts_spi0_cs_pull_up";
				reg = <0x1>;
				spi-max-frequency = <0x5b8d80>;
				status = "okay";
			};
		};
	};

	fragment@27 {
		target = <0xffffffff>;

		__overlay__ {

			fts_spi_pull_down_ctrl {
				phandle = <0x5b>;

				pins_cmd_dat {
					output-low;
					pinmux = <0x1f00>;
				};
			};

			fts_spi_pull_up_ctrl {
				phandle = <0x5c>;

				pins_cmd_dat {
					drive-strength = <0x2>;
					pinmux = <0x1f01>;
				};
			};
		};
	};

	fragment@28 {
		target = <0xffffffff>;

		__overlay__ {
		};
	};

	fragment@29 {
		target = <0xffffffff>;

		__overlay__ {
		};
	};

	fragment@3 {
		target = <0xffffffff>;

		__overlay__ {
			#address-cells = <0x1>;
			#size-cells = <0x0>;
			clock-frequency = <0x61a80>;
			status = "okay";

			camera_eeprom1@51 {
				compatible = "mediatek,camera_eeprom";
				phandle = <0x62>;
				reg = <0x51>;
				status = "okay";
			};

			camera_sub@1a {
				#thermal-sensor-cells = <0x0>;
				compatible = "mediatek,camera_sub";
				phandle = <0x36>;
				reg = <0x1a>;
				status = "okay";
			};
		};
	};

	fragment@30 {
		target = <0xffffffff>;

		__overlay__ {
		};
	};

	fragment@31 {
		target = <0xffffffff>;

		__overlay__ {

			aw882xx_smartpa_0@35 {
				#sound-dai-cells = <0x0>;
				aw-re-max = <0x7530>;
				aw-re-min = <0xfa0>;
				compatible = "awinic,aw882xx_smartpa";
				irq-gpio = <0xffffffff 0xa 0x0>;
				phandle = <0x5d>;
				reg = <0x35>;
				sound-channel = <0x0>;
				status = "okay";
				sync-load = <0x0>;
			};

			aw882xx_smartpa_1@34 {
				#sound-dai-cells = <0x0>;
				aw-re-max = <0x7530>;
				aw-re-min = <0xfa0>;
				compatible = "awinic,aw882xx_smartpa";
				irq-gpio = <0xffffffff 0x3 0x0>;
				phandle = <0x5e>;
				reg = <0x34>;
				sound-channel = <0x1>;
				status = "okay";
				sync-load = <0x0>;
			};
		};
	};

	fragment@32 {
		target = <0xffffffff>;

		__overlay__ {

			mediatek,speaker-codec {
				sound-dai = <0x5d 0x5e>;
			};
		};
	};

	fragment@33 {
		target = <0xffffffff>;

		__overlay__ {
		};
	};

	fragment@34 {
		target = <0xffffffff>;

		__overlay__ {
		};
	};

	fragment@35 {
		target = <0xffffffff>;

		__overlay__ {
			max_charger_voltage = <0xb71b00>;
		};
	};

	fragment@36 {
		target = <0xffffffff>;

		__overlay__ {
			battery_cv = <0x426030>;
			charger = <0xffffffff>;
			max_charger_voltage = <0xb71b00>;
		};
	};

	fragment@37 {
		target = <0xffffffff>;

		__overlay__ {
			charger = <0xffffffff>;
		};
	};

	fragment@38 {
		target = <0xffffffff>;

		__overlay__ {
			charger = <0xffffffff>;
			id-gpios = <0xffffffff 0xd 0x0>;
		};
	};

	fragment@39 {
		target = <0xffffffff>;

		__overlay__ {
			accdet-mic-mode = <0x1>;
			headset-eint-level-pol = <0x8>;
		};
	};

	fragment@4 {
		target = <0xffffffff>;

		__overlay__ {
			#address-cells = <0x1>;
			#size-cells = <0x0>;
			clock-frequency = <0x61a80>;
			status = "okay";

			camera_eeprom0@50 {
				compatible = "mediatek,camera_eeprom";
				phandle = <0x63>;
				reg = <0x50>;
				status = "okay";
			};

			camera_main@1a {
				#thermal-sensor-cells = <0x0>;
				compatible = "mediatek,camera_main";
				phandle = <0x35>;
				reg = <0x1a>;
				status = "okay";
			};

			camera_main_af@72 {
				compatible = "mediatek,camera_main_af";
				phandle = <0x64>;
				reg = <0x72>;
				status = "okay";
			};
		};
	};

	fragment@40 {
		target = <0xffffffff>;

		__overlay__ {
			status = "disabled";
		};
	};

	fragment@41 {
		target = <0xffffffff>;

		__overlay__ {
			status = "disabled";
		};
	};

	fragment@42 {
		target = <0xffffffff>;

		__overlay__ {
			status = "disabled";
		};
	};

	fragment@43 {
		target = <0xffffffff>;

		__overlay__ {
			status = "disabled";
		};
	};

	fragment@44 {
		target = <0xffffffff>;

		__overlay__ {
			GPIO_FDD_BAND_SUPPORT_DETECT_1ST_PIN = <0xffffffff 0x64 0x0>;
			GPIO_SIM1_HOT_PLUG = <0xffffffff 0x17 0x0>;
			GPIO_SIM1_SCLK = <0xffffffff 0x4d 0x0>;
			GPIO_SIM1_SIO = <0xffffffff 0x4f 0x0>;
			GPIO_SIM1_SRST = <0xffffffff 0x4e 0x0>;
			GPIO_SIM2_HOT_PLUG = <0xffffffff 0x18 0x0>;
			GPIO_SIM2_SCLK = <0xffffffff 0x50 0x0>;
			GPIO_SIM2_SIO = <0xffffffff 0x52 0x0>;
			GPIO_SIM2_SRST = <0xffffffff 0x51 0x0>;
		};
	};

	fragment@45 {
		target = <0xffffffff>;

		__overlay__ {
			gpio_init_default = <0x0 0x0 0x0 0x0 0x1 0x1 0x1 0x1 0x0 0x0 0x0 0x1 0x0 0x1 0x2 0x0 0x0 0x0 0x1 0x0 0x1 0x3 0x0 0x0 0x0 0x1 0x1 0x1 0x4 0x0 0x0 0x0 0x1 0x1 0x1 0x5 0x0 0x0 0x0 0x1 0x1 0x1 0x6 0x0 0x0 0x0 0x1 0x1 0x1 0x7 0x0 0x0 0x0 0x1 0x1 0x1 0x8 0x0 0x0 0x0 0x1 0x0 0x1 0x9 0x0 0x0 0x0 0x1 0x1 0x1 0xa 0x0 0x0 0x0 0x1 0x1 0x1 0xb 0x0 0x0 0x0 0x1 0x1 0x1 0xc 0x0 0x0 0x0 0x1 0x0 0x1 0xd 0x0 0x0 0x0 0x1 0x1 0x1 0xe 0x6 0x0 0x0 0x1 0x0 0x0 0xf 0x0 0x1 0x0 0x1 0x0 0x0 0x10 0x0 0x1 0x0 0x1 0x0 0x0 0x11 0x0 0x1 0x0 0x1 0x0 0x0 0x12 0x0 0x1 0x0 0x1 0x0 0x0 0x13 0x0 0x1 0x0 0x1 0x0 0x0 0x14 0x0 0x1 0x0 0x1 0x0 0x0 0x15 0x0 0x1 0x0 0x1 0x0 0x0 0x16 0x0 0x1 0x0 0x1 0x0 0x0 0x17 0x1 0x0 0x0 0x1 0x1 0x0 0x18 0x1 0x0 0x0 0x1 0x1 0x0 0x19 0x2 0x0 0x0 0x1 0x0 0x1 0x1a 0x2 0x0 0x0 0x1 0x0 0x1 0x1b 0x0 0x0 0x0 0x1 0x0 0x0 0x1c 0x1 0x0 0x0 0x1 0x1 0x1 0x1d 0x1 0x0 0x0 0x0 0x0 0x1 0x1e 0x1 0x0 0x0 0x0 0x0 0x1 0x1f 0x1 0x0 0x0 0x0 0x0 0x1 0x20 0x1 0x0 0x0 0x0 0x0 0x1 0x21 0x1 0x0 0x0 0x0 0x0 0x1 0x22 0x0 0x1 0x0 0x1 0x0 0x0 0x23 0x0 0x1 0x0 0x1 0x0 0x0 0x24 0x0 0x1 0x0 0x1 0x0 0x0 0x25 0x0 0x1 0x0 0x1 0x0 0x0 0x26 0x0 0x1 0x0 0x1 0x0 0x1 0x27 0x0 0x1 0x0 0x1 0x0 0x1 0x28 0x0 0x1 0x0 0x1 0x0 0x1 0x29 0x0 0x1 0x0 0x1 0x0 0x1 0x2a 0x0 0x1 0x0 0x1 0x0 0x0 0x2b 0x0 0x1 0x0 0x1 0x0 0x0 0x2c 0x0 0x1 0x0 0x1 0x0 0x0 0x2d 0x0 0x1 0x1 0x1 0x0 0x0 0x2e 0x0 0x1 0x0 0x1 0x0 0x0 0x2f 0x0 0x1 0x0 0x1 0x0 0x0 0x30 0x0 0x1 0x0 0x1 0x0 0x0 0x31 0x0 0x1 0x0 0x1 0x0 0x0 0x32 0x0 0x1 0x0 0x1 0x0 0x1 0x33 0x0 0x1 0x0 0x1 0x0 0x1 0x34 0x0 0x1 0x0 0x1 0x0 0x1 0x35 0x0 0x1 0x0 0x1 0x0 0x1 0x36 0x0 0x0 0x0 0x1 0x0 0x0 0x37 0x0 0x0 0x0 0x1 0x0 0x0 0x38 0x0 0x0 0x0 0x1 0x0 0x0 0x39 0x0 0x0 0x0 0x1 0x0 0x0 0x3a 0x0 0x0 0x0 0x1 0x0 0x0 0x3b 0x0 0x0 0x0 0x1 0x0 0x0 0x3c 0x0 0x0 0x0 0x1 0x0 0x0 0x3d 0x0 0x0 0x0 0x1 0x0 0x0 0x3e 0x0 0x0 0x0 0x1 0x0 0x0 0x3f 0x0 0x0 0x0 0x1 0x0 0x0 0x40 0x0 0x0 0x0 0x1 0x0 0x0 0x41 0x0 0x0 0x0 0x1 0x0 0x0 0x42 0x1 0x0 0x0 0x1 0x1 0x0 0x43 0x1 0x0 0x0 0x1 0x1 0x1 0x44 0x0 0x0 0x0 0x1 0x0 0x1 0x45 0x0 0x0 0x0 0x1 0x1 0x1 0x4d 0x1 0x0 0x0 0x0 0x0 0x1 0x4e 0x1 0x0 0x0 0x0 0x0 0x1 0x4f 0x1 0x0 0x0 0x1 0x1 0x1 0x50 0x1 0x0 0x0 0x0 0x0 0x1 0x51 0x1 0x0 0x0 0x0 0x0 0x1 0x52 0x1 0x0 0x0 0x1 0x1 0x1 0x53 0x1 0x0 0x0 0x1 0x0 0x1 0x54 0x1 0x0 0x0 0x0 0x0 0x1 0x55 0x1 0x0 0x0 0x0 0x0 0x1 0x56 0x1 0x0 0x0 0x1 0x0 0x0 0x57 0x1 0x0 0x0 0x1 0x0 0x0 0x58 0x1 0x0 0x0 0x1 0x0 0x0 0x59 0x1 0x0 0x0 0x1 0x0 0x0 0x5a 0x1 0x0 0x0 0x1 0x0 0x0 0x5b 0x1 0x0 0x0 0x1 0x0 0x0 0x5c 0x1 0x0 0x0 0x1 0x0 0x0 0x5d 0x1 0x0 0x0 0x1 0x0 0x0 0x5e 0x1 0x0 0x0 0x1 0x0 0x0 0x5f 0x1 0x0 0x0 0x1 0x0 0x0 0x60 0x1 0x0 0x0 0x1 0x0 0x0 0x61 0x1 0x0 0x0 0x1 0x0 0x0 0x62 0x1 0x0 0x0 0x1 0x0 0x0 0x63 0x1 0x0 0x0 0x1 0x0 0x0 0x64 0x0 0x0 0x0 0x0 0x0 0x0 0x65 0x0 0x0 0x0 0x0 0x0 0x0 0x66 0x1 0x0 0x0 0x1 0x0 0x0 0x67 0x2 0x0 0x0 0x1 0x0 0x0 0x68 0x2 0x0 0x0 0x0 0x0 0x0 0x69 0x1 0x0 0x0 0x1 0x0 0x0 0x6a 0x1 0x0 0x0 0x1 0x0 0x0 0x6b 0x1 0x0 0x0 0x1 0x0 0x0 0x6c 0x1 0x0 0x0 0x1 0x0 0x0 0x6d 0x1 0x0 0x0 0x1 0x0 0x0 0x6e 0x1 0x0 0x0 0x1 0x0 0x0 0x6f 0x0 0x0 0x0 0x0 0x0 0x0 0x70 0x1 0x0 0x0 0x0 0x0 0x0 0x71 0x1 0x0 0x0 0x1 0x0 0x0 0x72 0x1 0x0 0x0 0x0 0x0 0x0 0x73 0x1 0x0 0x0 0x1 0x0 0x0 0x74 0x1 0x0 0x0 0x0 0x0 0x0 0x75 0x1 0x0 0x0 0x1 0x0 0x0 0x76 0x1 0x0 0x0 0x0 0x0 0x0 0x77 0x1 0x0 0x0 0x1 0x0 0x0 0x78 0x1 0x0 0x0 0x0 0x0 0x0 0x79 0x1 0x0 0x0 0x1 0x0 0x0 0x7a 0x1 0x0 0x0 0x0 0x0 0x0 0x7b 0x1 0x0 0x0 0x0 0x0 0x0 0x7c 0x1 0x0 0x0 0x1 0x0 0x0 0x7d 0x1 0x0 0x0 0x1 0x0 0x0 0x7e 0x1 0x0 0x0 0x1 0x0 0x0 0x7f 0x1 0x0 0x0 0x1 0x0 0x0 0x80 0x1 0x0 0x0 0x1 0x0 0x0 0x81 0x1 0x0 0x0 0x1 0x0 0x0 0x82 0x1 0x0 0x0 0x1 0x1 0x1 0x83 0x1 0x0 0x0 0x1 0x1 0x1 0x84 0x1 0x0 0x0 0x1 0x1 0x0 0x85 0x1 0x0 0x0 0x1 0x1 0x0 0x86 0x1 0x0 0x0 0x1 0x1 0x1 0x87 0x1 0x0 0x0 0x1 0x1 0x1 0x88 0x1 0x0 0x0 0x1 0x1 0x1 0x89 0x1 0x0 0x0 0x1 0x1 0x1 0x8a 0x1 0x0 0x0 0x1 0x1 0x1 0x8b 0x1 0x0 0x0 0x1 0x1 0x1 0x8c 0x1 0x0 0x0 0x1 0x1 0x1 0x8d 0x1 0x0 0x0 0x1 0x1 0x1 0x8e 0x1 0x0 0x0 0x1 0x1 0x1 0x8f 0x1 0x0 0x0 0x1 0x1 0x1 0x90 0x1 0x0 0x0 0x1 0x1 0x1 0x91 0x1 0x0 0x0 0x1 0x1 0x1 0x92 0x1 0x0 0x0 0x1 0x1 0x1 0x93 0x1 0x0 0x0 0x1 0x1 0x1 0x94 0x2 0x0 0x0 0x1 0x1 0x1 0x95 0x2 0x0 0x0 0x1 0x1 0x1 0x96 0x0 0x1 0x0 0x1 0x0 0x1 0x97 0x0 0x1 0x1 0x1 0x0 0x1 0x98 0x0 0x1 0x0 0x1 0x0 0x1 0x99 0x0 0x0 0x0 0x1 0x0 0x1 0x9a 0x0 0x1 0x0 0x1 0x0 0x1 0x9b 0x0 0x1 0x0 0x1 0x0 0x1 0x9c 0x0 0x1 0x0 0x1 0x0 0x1 0x9d 0x0 0x1 0x0 0x1 0x0 0x1 0x9e 0x0 0x1 0x0 0x1 0x0 0x0 0x9f 0x0 0x1 0x0 0x1 0x0 0x0 0xa0 0x1 0x0 0x0 0x0 0x0 0x1 0xa1 0x1 0x0 0x0 0x0 0x0 0x1 0xa2 0x1 0x0 0x0 0x0 0x0 0x1 0xa3 0x1 0x0 0x0 0x1 0x0 0x1 0xa4 0x1 0x0 0x0 0x0 0x0 0x1 0xa5 0x1 0x0 0x0 0x0 0x0 0x1 0xa6 0x1 0x0 0x0 0x0 0x0 0x1 0xa7 0x1 0x0 0x0 0x1 0x0 0x1 0xa8 0x1 0x0 0x0 0x0 0x0 0x0 0xa9 0x1 0x0 0x0 0x0 0x0 0x1 0xaa 0x1 0x0 0x0 0x0 0x0 0x1 0xab 0x1 0x0 0x0 0x0 0x0 0x1 0xac 0x1 0x0 0x0 0x0 0x0 0x1 0xad 0x1 0x0 0x0 0x1 0x0 0x1 0xae 0x1 0x0 0x0 0x1 0x0 0x1 0xaf 0x1 0x0 0x0 0x1 0x0 0x1 0xb0 0x1 0x0 0x0 0x1 0x0 0x1 0xb1 0x0 0x0 0x0 0x1 0x0 0x0 0xb2 0x0 0x0 0x0 0x1 0x0 0x0 0xb3 0x0 0x0 0x0 0x1 0x0 0x0 0xb4 0x0 0x0 0x0 0x1 0x0 0x0 0xb5 0x0 0x0 0x0 0x1 0x0 0x0 0xb6 0x0 0x0 0x0 0x1 0x0 0x0 0xb7 0x0 0x0 0x0 0x1 0x0 0x0 0xb8 0x0 0x0 0x0 0x1 0x0 0x0 0xb9 0x0 0x0 0x0 0x1 0x0 0x0 0xba 0x1 0x0 0x0 0x1 0x1 0x1 0xbb 0x1 0x0 0x0 0x1 0x1 0x1 0xbc 0x0 0x0 0x0 0x1 0x0 0x0 0xbd 0x0 0x0 0x0 0x1 0x0 0x0 0xbe 0x0 0x0 0x0 0x1 0x0 0x0 0xbf 0x0 0x0 0x0 0x1 0x0 0x0 0xc0 0x0 0x0 0x0 0x1 0x0 0x0 0xc1 0x0 0x0 0x0 0x1 0x0 0x0 0xc2 0x0 0x0 0x0 0x1 0x0 0x0 0xc3 0x0 0x0 0x0 0x1 0x0 0x0 0xc4 0x0 0x0 0x0 0x1 0x0 0x0 0xc5 0x0 0x0 0x0 0x1 0x0 0x0 0xc6 0x0 0x0 0x0 0x1 0x0 0x0 0xc7 0x0 0x0 0x0 0x1 0x0 0x0 0xc8 0x0 0x0 0x0 0x1 0x0 0x0 0xc9 0x0 0x0 0x0 0x1 0x0 0x0 0xca 0x0 0x0 0x0 0x1 0x0 0x0 0xcb 0x0 0x0 0x0 0x1 0x0 0x0 0xcc 0x0 0x0 0x0 0x1 0x0 0x0 0xcd 0x0 0x0 0x0 0x1 0x0 0x0 0xce 0x0 0x0 0x0 0x1 0x0 0x0 0xcf 0x0 0x0 0x0 0x1 0x0 0x0 0xd0 0x0 0x0 0x0 0x1 0x0 0x0 0xd1 0x0 0x0 0x0 0x1 0x0 0x0 0xd2 0x0 0x0 0x0 0x1 0x0 0x0 0xd3 0x0 0x0 0x0 0x1 0x0 0x0 0xd4 0x0 0x0 0x0 0x1 0x0 0x0 0xd5 0x0 0x0 0x0 0x1 0x0 0x0 0xd6 0x0 0x0 0x0 0x1 0x0 0x0 0xd7 0x0 0x0 0x0 0x1 0x0 0x0 0xd8 0x0 0x0 0x0 0x1 0x0 0x0 0xd9 0x0 0x0 0x0 0x1 0x0 0x0 0xda 0x0 0x0 0x0 0x1 0x0 0x0 0xdb 0x0 0x0 0x0 0x1 0x0 0x0 0xdc 0x0 0x0 0x0 0x1 0x0 0x0 0xdd 0x0 0x0 0x0 0x1 0x0 0x0>;
		};
	};

	fragment@46 {
		target = <0xffffffff>;

		__overlay__ {
			interrupt-parent = <0xffffffff>;
			interrupts = <0x4 0x8>;
			status = "okay";
		};
	};

	fragment@47 {
		target = <0xffffffff>;

		__overlay__ {
			interrupt-parent = <0xffffffff>;
			interrupts = <0x9 0x2>;
			status = "okay";
		};
	};

	fragment@48 {
		target = <0xffffffff>;

		__overlay__ {
			interrupt-parent = <0xffffffff>;
			interrupts = <0x53 0x1>;
			status = "okay";
		};
	};

	fragment@49 {
		target = <0xffffffff>;

		__overlay__ {
			compatible = "mediatek,md1_sim1_hot_plug_eint-eint";
			debounce = <0x0 0x2710>;
			dedicated = <0x0 0x0>;
			interrupts = <0x0 0x8>;
			sockettype = <0x0 0x0>;
			src_pin = <0x0 0x1>;
			status = "okay";
		};
	};

	fragment@5 {
		target = <0xffffffff>;

		__overlay__ {

			camera_main {
				phandle = <0x65>;
				polling-delay = <0x3e8>;
				polling-delay-passive = <0x0>;
				thermal-sensors = <0x35>;
			};

			camera_main_two {
				phandle = <0x67>;
				polling-delay = <0x3e8>;
				polling-delay-passive = <0x0>;
				thermal-sensors = <0x37>;
			};

			camera_sub {
				phandle = <0x66>;
				polling-delay = <0x3e8>;
				polling-delay-passive = <0x0>;
				thermal-sensors = <0x36>;
			};
		};
	};

	fragment@50 {
		target = <0xffffffff>;

		__overlay__ {
			compatible = "mediatek,md1_sim2_hot_plug_eint-eint";
			debounce = <0x1 0x2710>;
			dedicated = <0x1 0x0>;
			interrupts = <0x1 0x8>;
			sockettype = <0x1 0x0>;
			src_pin = <0x1 0x2>;
			status = "okay";
		};
	};

	fragment@51 {
		target = <0xffffffff>;

		__overlay__ {
			mediatek,hw-dl-key0 = <0x1>;
			mediatek,hw-dl-key1 = <0x0>;
			mediatek,hw-dl-key2 = <0x8>;
			mediatek,hw-factory-key = <0x1>;
			mediatek,hw-init-map = <0x73 0x72 0x0 0x0 0x0 0x0 0x0 0x0 0x0 0x0 0x0 0x0 0x0 0x0 0x0 0x0 0x0 0x0 0x0 0x0 0x0 0x0 0x0 0x0 0x0 0x0 0x0 0x0 0x0 0x0 0x0 0x0 0x0 0x0 0x0 0x0 0x0 0x0 0x0 0x0 0x0 0x0 0x0 0x0 0x0 0x0 0x0 0x0 0x0 0x0 0x0 0x0 0x0 0x0 0x0 0x0 0x0 0x0 0x0 0x0 0x0 0x0 0x0 0x0 0x0 0x0 0x0 0x0 0x0 0x0 0x0 0x0>;
			mediatek,hw-map-num = <0x48>;
			mediatek,hw-pwrkey = <0x8>;
			mediatek,hw-recovery-key = <0x0>;
			mediatek,key-debounce = <0x400>;
			mediatek,pwkey-gpio-din = <0x0>;
			mediatek,pwrkey-eint-gpio = <0x0>;
			mediatek,sw-pwrkey = <0x74>;
			mediatek,use-extend-type = <0x0>;
			status = "okay";
		};
	};

	fragment@6 {
		target = <0xffffffff>;

		__overlay__ {

			lm3643@63 {
				#cooling-cells = <0x2>;
				compatible = "mediatek,lm3643";
				phandle = <0x68>;
				reg = <0x63>;
				status = "okay";

				flash@0 {
					ct = <0x0>;
					part = <0x0>;
					reg = <0x0>;
					type = <0x0>;

					port@0 {

						endpoint {
							phandle = <0x3a>;
							remote-endpoint = <0x38>;
						};
					};
				};

				flash@1 {
					ct = <0x1>;
					part = <0x0>;
					reg = <0x1>;
					type = <0x0>;

					port@1 {

						endpoint {
							phandle = <0x3b>;
							remote-endpoint = <0x39>;
						};
					};
				};
			};
		};
	};

	fragment@7 {
		target = <0xffffffff>;

		__overlay__ {

			port@0 {

				endpoint {
					phandle = <0x38>;
					remote-endpoint = <0x3a>;
				};
			};

			port@1 {

				endpoint {
					phandle = <0x39>;
					remote-endpoint = <0x3b>;
				};
			};
		};
	};

	fragment@8 {
		target = <0xffffffff>;

		__overlay__ {
			status = "okay";
		};
	};

	fragment@9 {
		target = <0xffffffff>;

		__overlay__ {

			hwen_high {
				phandle = <0x3c>;

				pins_cmd_dat {
					output-high;
					pinmux = <0x9a00>;
					slew-rate = <0x1>;
				};
			};

			hwen_low {
				phandle = <0x3d>;

				pins_cmd_dat {
					output-low;
					pinmux = <0x9a00>;
					slew-rate = <0x1>;
				};
			};

			mode_high {
				phandle = <0x3e>;

				pins_cmd_dat {
					output-high;
					pinmux = <0x9a00>;
					slew-rate = <0x1>;
				};
			};

			mode_low {
				phandle = <0x3f>;

				pins_cmd_dat {
					output-low;
					pinmux = <0x9a00>;
					slew-rate = <0x1>;
				};
			};
		};
	};
};
